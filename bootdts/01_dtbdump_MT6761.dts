/dts-v1/;

/ {
	#address-cells = <0x2>;
	#size-cells = <0x2>;
	compatible = "mediatek,MT6761";
	interrupt-parent = <0x1>;
	model = "MT6761";

	HardwareInfo {
		compatible = "huaqin,hardware_info";
		phandle = <0x101>;
	};

	__symbols__ {
		DPIDLE = "/cpus/idle-states/dpidle";
		MCDI_CLUSTER = "/cpus/idle-states/mcdi-cluster";
		MCDI_CPU = "/cpus/idle-states/mcdi-cpu";
		SODI = "/cpus/idle-states/sodi";
		SODI3 = "/cpus/idle-states/sodi3";
		STANDBY = "/cpus/idle-states/standby";
		SUSPEND = "/cpus/idle-states/suspend";
		accdet = "/accdet";
		apdma = "/dma-controller@11000580";
		apmixed = "/apmixed@1000c000";
		audclk = "/audclk@11220000";
		audgpio = "/mt_soc_dl1_pcm@11220000";
		audio = "/audio@11220000";
		auxadc = "/auxadc@11001000";
		bat_gm30 = "/battery";
		btcvsd_snd = "/mtk-btcvsd-snd@18050000";
		camera_af_hw_node = "/camera_af_hw_node";
		camera_pins_cam0_mclk_off = "/pinctrl@10005000/camera_pins_cam0_mclk_off";
		camera_pins_cam0_mclk_on = "/pinctrl@10005000/camera_pins_cam0_mclk_on";
		camera_pins_cam0_pnd0 = "/pinctrl@10005000/cam0@2";
		camera_pins_cam0_pnd1 = "/pinctrl@10005000/cam0@3";
		camera_pins_cam0_rst0 = "/pinctrl@10005000/cam0@0";
		camera_pins_cam0_rst1 = "/pinctrl@10005000/cam0@1";
		camera_pins_cam1_mclk_off = "/pinctrl@10005000/camera_pins_cam1_mclk_off";
		camera_pins_cam1_mclk_on = "/pinctrl@10005000/camera_pins_cam1_mclk_on";
		camera_pins_cam1_pnd0 = "/pinctrl@10005000/cam1@2";
		camera_pins_cam1_pnd1 = "/pinctrl@10005000/cam1@3";
		camera_pins_cam1_rst0 = "/pinctrl@10005000/cam1@0";
		camera_pins_cam1_rst1 = "/pinctrl@10005000/cam1@1";
		camera_pins_cam_ldo_rear_vcama_0 = "/pinctrl@10005000/cam0@vcama0";
		camera_pins_cam_ldo_rear_vcama_1 = "/pinctrl@10005000/cam0@vcama1";
		camera_pins_cam_ldo_sub_vcamd_0 = "/pinctrl@10005000/cam1@vcamd0";
		camera_pins_cam_ldo_sub_vcamd_1 = "/pinctrl@10005000/cam1@vcamd1";
		camera_pins_default = "/pinctrl@10005000/camdefault";
		camsys = "/camsys@15000000";
		ccifdriver = "/ccifdriver@10209000";
		charger = "/charger";
		chosen = "/chosen";
		cldmadriver = "/cldmadriver@10014000";
		clk13m = "/clocks/clk13m";
		clk26m = "/clocks/clk26m";
		clk32k = "/clocks/clk32k";
		clock_buffer_ctrl = "/pwrap@1000d000/main_pmic/clock_buffer_ctrl";
		cluster0_opp = "/opp_table0";
		cm_mgr = "/cm_mgr@10200000";
		consys = "/consys@18002000";
		consys_mem = "/reserved-memory/consys-reserve-memory";
		cpu0 = "/cpus/cpu@000";
		cpu1 = "/cpus/cpu@001";
		cpu2 = "/cpus/cpu@002";
		cpu3 = "/cpus/cpu@003";
		cpu_dbgapb = "/cpu_dbgapb@0d410000";
		cpu_freq_segment = "/efuse@11c50000/segment@1c";
		dcm = "/dcm@10001000";
		disp_color0 = "/disp_color0@1400f000";
		disp_mutex0 = "/disp_mutex0@14001000";
		dispsys_config = "/dispsys_config@14000000";
		dsi_te = "/dsi_te";
		dvfsrc = "/dvfsrc@10012000";
		dvfsrc_freq_opp0 = "/dvfsrc@10012000/opp0";
		dvfsrc_freq_opp1 = "/dvfsrc@10012000/opp1";
		dvfsrc_freq_opp2 = "/dvfsrc@10012000/opp2";
		dynamic_options = "/dynamic_options";
		efuse = "/efuse@11c50000";
		efuse_analog7 = "/efuse@11c50000/efuse_analog7@1ac";
		efuse_segment = "/efuse@11c50000/segment@78";
		eint = "/eint@1000b000";
		ext_32k = "/pwrap@1000d000/main_pmic/mtk_rtc/ext_32k";
		fg_init = "/pwrap@1000d000/main_pmic/mtk_rtc/fg_init";
		fg_soc = "/pwrap@1000d000/main_pmic/mtk_rtc/fg_soc";
		fhctl = "/fhctl@1000ce00";
		flashlight_core = "/flashlight_core";
		flashlight_pins_default = "/pinctrl@10005000/flashlight_default";
		flashlight_pins_enf_gpio_high = "/pinctrl@10005000/enf_gpio@1";
		flashlight_pins_enf_gpio_low = "/pinctrl@10005000/enf_gpio@0";
		flashlight_pins_enm_gpio_high = "/pinctrl@10005000/enm_gpio@1";
		flashlight_pins_enm_gpio_low = "/pinctrl@10005000/enm_gpio@0";
		flashlight_pins_enm_pwm_high = "/pinctrl@10005000/enm_pwm@1";
		flashlight_pins_enm_pwm_low = "/pinctrl@10005000/enm_pwm@0";
		flashlights_sgm3785_gpio = "/flashlights_sgm3785_gpio";
		gce = "/gce@10238000";
		gce_mbox = "/gce_mbox@10238000";
		ged = "/ged";
		gic = "/interrupt-controller@0c000000";
		goodix_fp = "/fingerprint";
		gpio = "/gpio@10005000";
		gpio_usage_mapping = "/gpio";
		gpufreq = "/gpufreq";
		hwinfo = "/HardwareInfo";
		hwrng = "/hwrng";
		i2c0 = "/i2c0@11007000";
		i2c1 = "/i2c1@11008000";
		i2c2 = "/i2c2@11009000";
		i2c3 = "/i2c3@1100f000";
		i2c4 = "/i2c4@11011000";
		i2c5 = "/i2c5@11016000";
		i2c6 = "/i2c6@1100d000";
		i2c7 = "/i2c7";
		i2c8 = "/i2c8";
		i2c9 = "/i2c9";
		i2c_common = "/i2c_common";
		infracfg_ao = "/infracfg_ao@10001000";
		io_cfg_bl = "/io_cfg_bl@10002600";
		io_cfg_lb = "/io_cfg_lb@10002400";
		io_cfg_lm = "/io_cfg_lm@10002200";
		io_cfg_lt = "/io_cfg_lt@10002000";
		io_cfg_rb = "/io_cfg_rb@10002a00";
		io_cfg_rr = "/io_cfg_rr@10002800";
		io_cfg_rt = "/io_cfg_rt@10002c00";
		iommu = "/m4u@10205000";
		irq_nfc = "/irq_nfc";
		kd_camera_hw1 = "/kd_camera_hw1@15040000";
		keypad = "/kp@10010000";
		lcd_bias = "/lcd_bias";
		lcd_bias_pins_default = "/pinctrl@10005000/lcd_bias_pins_default";
		lcd_bias_pins_enn0 = "/pinctrl@10005000/lcd_bias_gpio_enn0";
		lcd_bias_pins_enn1 = "/pinctrl@10005000/lcd_bias_gpio_enn1";
		lcd_bias_pins_enp0 = "/pinctrl@10005000/lcd_bias_gpio_enp0";
		lcd_bias_pins_enp1 = "/pinctrl@10005000/lcd_bias_gpio_enp1";
		lk_charger = "/lk_charger";
		main_pmic = "/pwrap@1000d000/main_pmic";
		md1_sim1_hot_plug_eint = "/md1_sim1_hot_plug_eint";
		md1_sim2_hot_plug_eint = "/md1_sim2_hot_plug_eint";
		md_auxadc = "/md_auxadc";
		mddriver = "/mddriver@10014000";
		mdp_ccorr = "/mdp_ccorr0@14005000";
		mdp_rdma0 = "/mdp_rdma0@14004000";
		mdp_rsz0 = "/mdp_rsz0@14006000";
		mdp_rsz1 = "/mdp_rsz1@14007000";
		mdp_tdshp0 = "/mdp_tdshp0@1400a000";
		mdp_wdma0 = "/mdp_wdma0@14008000";
		mdp_wrot0 = "/mdp_wrot0@14009000";
		memory_ssmr_features = "/memory-ssmr-features";
		mfg_cfg = "/mfg_cfg@13ffe000";
		mfg_clark = "/mfg_clark@13000000";
		mipi_rx_ana_csi0a = "/mipi_rx_ana_csi0a@11c10000";
		mipi_rx_ana_csi0b = "/mipi_rx_ana_csi0b@11c11000";
		mipi_rx_ana_csi1a = "/mipi_rx_ana_csi1a@11c12000";
		mipi_rx_ana_csi1b = "/mipi_rx_ana_csi1b@11c13000";
		mipi_rx_ana_csi2a = "/mipi_rx_ana_csi2a@11c14000";
		mipi_rx_ana_csi2b = "/mipi_rx_ana_csi2b@11c15000";
		mm_mutex = "/mm_mutex@14016000";
		mmsys_config = "/mmsys_config@14000000";
		mrdump_ext_rst = "/mrdump_ext_rst";
		msdc0 = "/msdc@11230000";
		msdc0_pins_default = "/pinctrl@10005000/msdc0@default";
		msdc0_pins_hs200 = "/pinctrl@10005000/msdc0@hs200";
		msdc0_pins_hs400 = "/pinctrl@10005000/msdc0@hs400";
		msdc0_register_setting_default = "/pinctrl@10005000/msdc0@register_default";
		msdc1 = "/msdc@11240000";
		msdc1_ins = "/msdc1_ins@0";
		msdc1_pins_ddr50 = "/pinctrl@10005000/msdc1@ddr50";
		msdc1_pins_default = "/pinctrl@10005000/msdc1@default";
		msdc1_pins_sdr104 = "/pinctrl@10005000/msdc1@sdr104";
		msdc1_pins_sdr50 = "/pinctrl@10005000/msdc1@sdr50";
		msdc1_register_setting_default = "/pinctrl@10005000/msdc1@register_default";
		msdc2 = "/msdc@11250000";
		msdc3 = "/msdc@11260000";
		msdc3_pins_default = "/pinctrl@10005000/msdc3@default";
		msdc3_register_setting_default = "/pinctrl@10005000/msdc3@register_default";
		mt6357_ts_buck1 = "/pwrap@1000d000/main_pmic/mt6357_ts_buck1";
		mt6357_ts_buck2 = "/pwrap@1000d000/main_pmic/mt6357_ts_buck2";
		mt6357keys = "/pwrap@1000d000/main_pmic/mt6357keys";
		mt6357regulator = "/pwrap@1000d000/main_pmic/mt6357regulator";
		mt6370_chg = "/mt6370_pmu_dts/charger";
		mt6370_pmu = "/mt6370_pmu_dts";
		mt6370_typec = "/type_c_port0";
		mt_pmic_vaud28_ldo_reg = "/pwrap@1000d000/main_pmic/mt6357regulator/ldo_vaud28";
		mt_pmic_vaux18_ldo_reg = "/pwrap@1000d000/main_pmic/mt6357regulator/ldo_vaux18";
		mt_pmic_vcama_ldo_reg = "/pwrap@1000d000/main_pmic/mt6357regulator/ldo_vcama";
		mt_pmic_vcamaf_ldo_reg = "/pwrap@1000d000/main_pmic/mt6357regulator/ldo_vcamaf";
		mt_pmic_vcamd_ldo_reg = "/pwrap@1000d000/main_pmic/mt6357regulator/ldo_vcamd";
		mt_pmic_vcamio_ldo_reg = "/pwrap@1000d000/main_pmic/mt6357regulator/ldo_vcamio";
		mt_pmic_vcn18_ldo_reg = "/pwrap@1000d000/main_pmic/mt6357regulator/ldo_vcn18";
		mt_pmic_vcn28_ldo_reg = "/pwrap@1000d000/main_pmic/mt6357regulator/ldo_vcn28";
		mt_pmic_vcn33_bt_ldo_reg = "/pwrap@1000d000/main_pmic/mt6357regulator/ldo_vcn33_bt";
		mt_pmic_vcn33_wifi_ldo_reg = "/pwrap@1000d000/main_pmic/mt6357regulator/ldo_vcn33_wifi";
		mt_pmic_vcore_buck_reg = "/pwrap@1000d000/main_pmic/mt6357regulator/buck_vcore";
		mt_pmic_vdram_ldo_reg = "/pwrap@1000d000/main_pmic/mt6357regulator/ldo_vdram";
		mt_pmic_vefuse_ldo_reg = "/pwrap@1000d000/main_pmic/mt6357regulator/ldo_vefuse";
		mt_pmic_vemc_ldo_reg = "/pwrap@1000d000/main_pmic/mt6357regulator/ldo_vemc";
		mt_pmic_vfe28_ldo_reg = "/pwrap@1000d000/main_pmic/mt6357regulator/ldo_vfe28";
		mt_pmic_vibr_ldo_reg = "/pwrap@1000d000/main_pmic/mt6357regulator/ldo_vibr";
		mt_pmic_vio18_ldo_reg = "/pwrap@1000d000/main_pmic/mt6357regulator/ldo_vio18";
		mt_pmic_vio28_ldo_reg = "/pwrap@1000d000/main_pmic/mt6357regulator/ldo_vio28";
		mt_pmic_vldo28_ldo_reg = "/pwrap@1000d000/main_pmic/mt6357regulator/ldo_vldo28";
		mt_pmic_vmc_ldo_reg = "/pwrap@1000d000/main_pmic/mt6357regulator/ldo_vmc";
		mt_pmic_vmch_ldo_reg = "/pwrap@1000d000/main_pmic/mt6357regulator/ldo_vmch";
		mt_pmic_vmodem_buck_reg = "/pwrap@1000d000/main_pmic/mt6357regulator/buck_vmodem";
		mt_pmic_vpa_buck_reg = "/pwrap@1000d000/main_pmic/mt6357regulator/buck_vpa";
		mt_pmic_vproc_buck_reg = "/pwrap@1000d000/main_pmic/mt6357regulator/buck_vproc";
		mt_pmic_vrf12_ldo_reg = "/pwrap@1000d000/main_pmic/mt6357regulator/ldo_vrf12";
		mt_pmic_vrf18_ldo_reg = "/pwrap@1000d000/main_pmic/mt6357regulator/ldo_vrf18";
		mt_pmic_vs1_buck_reg = "/pwrap@1000d000/main_pmic/mt6357regulator/buck_vs1";
		mt_pmic_vsim1_ldo_reg = "/pwrap@1000d000/main_pmic/mt6357regulator/ldo_vsim1";
		mt_pmic_vsim2_ldo_reg = "/pwrap@1000d000/main_pmic/mt6357regulator/ldo_vsim2";
		mt_pmic_vsram_others_ldo_reg = "/pwrap@1000d000/main_pmic/mt6357regulator/ldo_vsram_others";
		mt_pmic_vsram_proc_ldo_reg = "/pwrap@1000d000/main_pmic/mt6357regulator/ldo_vsram_proc";
		mt_pmic_vusb33_ldo_reg = "/pwrap@1000d000/main_pmic/mt6357regulator/ldo_vusb33";
		mt_pmic_vxo22_ldo_reg = "/pwrap@1000d000/main_pmic/mt6357regulator/ldo_vxo22";
		mtk_charger_type = "/pwrap@1000d000/main_pmic/mtk_charger_type";
		mtk_gauge = "/pwrap@1000d000/main_pmic/mtk_gauge";
		mtk_rtc = "/pwrap@1000d000/main_pmic/mtk_rtc";
		mtk_ts_pmic = "/pwrap@1000d000/main_pmic/mtk_ts_pmic";
		mtkfb = "/mtkfb@0";
		nfc = "/nfc";
		odm = "/odm";
		otg_iddig = "/otg_iddig";
		otg_vbus = "/mt6370_pmu_dts/charger/usb-otg-vbus";
		pbm = "/pbm";
		pd_adapter = "/pd_adapter";
		pdc = "/pdc";
		pe = "/pe";
		pe2 = "/pe2";
		pe4 = "/pe4";
		pericfg = "/pericfg@10003000";
		pio = "/pinctrl@10005000";
		pmic_accdet = "/pwrap@1000d000/main_pmic/pmic_accdet";
		pmic_auxadc = "/pwrap@1000d000/main_pmic/pmic_auxadc";
		pmic_clock_buffer_ctrl = "/pmic_clock_buffer_ctrl";
		pmic_codec = "/pwrap@1000d000/main_pmic/pmic_codec";
		pmic_efuse = "/pwrap@1000d000/main_pmic/pmic_efuse";
		pwm = "/pwm@11006000";
		pwrap = "/pwrap@1000d000";
		radio_md_cfg = "/radio_md_cfg";
		reserved_memory = "/reserved-memory";
		rt9465_slave_chr = "/rt9465_slave_chr";
		scp = "/scp@10500000";
		scp_infra = "/scp_infra@10001000";
		scpsys = "/scpsys@10001000";
		sleep = "/sleep@10006000";
		smart_pa = "/smart_pa";
		smi_common = "/smi_common@14002000";
		smi_larb0 = "/smi_larb0@14003000";
		smi_larb1 = "/smi_larb1@17010000";
		smi_larb2 = "/smi_larb2@15001000";
		spi0 = "/spi0@1100a000";
		spi1 = "/spi1@11010000";
		spi2 = "/spi2@11012000";
		spi3 = "/spi3@11013000";
		spi4 = "/spi4@11014000";
		spi5 = "/spi5@11015000";
		ssmr_cma_mem = "/reserved-memory/ssmr-reserved-cma_memory";
		subpmic_pmu_eint = "/mt6370_pmu_eint";
		syscfg_pctl_0 = "/syscfg_pctl_0@10005000";
		sysirq = "/intpol-controller@10200a80";
		tboard_thermistor1 = "/thermal-sensor1";
		tboard_thermistor2 = "/thermal-sensor2";
		tboard_thermistor3 = "/thermal-sensor3";
		tcpc_pd = "/tcpc_pd";
		thermal_efuse = "/efuse@11c50000/segment@190";
		timer = "/timer@10017000";
		topckgen = "/topckgen@10000000";
		toprgu = "/toprgu@10007000";
		touch = "/touch";
		uart0 = "/serial@11020000";
		uart1 = "/serial@11030000";
		usb = "/usb0@11200000";
		vcodecsys = "/vcodecsys@17000000";
		venc_gcon = "/venc_gcon@17000000";
		wifi_mem = "/reserved-memory/wifi-reserve-memory";
	};

	accdet {
		compatible = "mediatek,pmic-accdet";
		phandle = <0xb6>;
	};

	aes_top0@10016000 {
		compatible = "mediatek,aes_top0";
		reg = <0x0 0x10016000 0x0 0x1000>;
	};

	amms_control {
		compatible = "mediatek,amms";
		interrupts = <0x0 0x43 0x1>;
	};

	ap_ccif0@10209000 {
		compatible = "mediatek,ap_ccif0";
		interrupts = <0x0 0x5c 0x8>;
		reg = <0x0 0x10209000 0x0 0x1000>;
	};

	ap_ccif1@1020b000 {
		compatible = "mediatek,ap_ccif1";
		interrupts = <0x0 0x5e 0x8>;
		reg = <0x0 0x1020b000 0x0 0x1000>;
	};

	ap_ccif2@1023c000 {
		compatible = "mediatek,ap_ccif2";
		interrupts = <0x0 0x57 0x8>;
		reg = <0x0 0x1023c000 0x0 0x1000>;
	};

	ap_ccif3@1023e000 {
		compatible = "mediatek,ap_ccif3";
		interrupts = <0x0 0x5a 0x8>;
		reg = <0x0 0x1023e000 0x0 0x1000>;
	};

	ap_dma@11000000 {
		compatible = "mediatek,ap_dma";
		interrupts = <0x0 0x29 0x8>;
		reg = <0x0 0x11000000 0x0 0x1000>;
	};

	apcldmain@1021b000 {
		compatible = "mediatek,apcldmain";
		reg = <0x0 0x1021b000 0x0 0x100>;
	};

	apcldmain_ao@10014000 {
		compatible = "mediatek,apcldmain_ao";
		reg = <0x0 0x10014000 0x0 0x400>;
	};

	apcldmamisc@1021b800 {
		compatible = "mediatek,apcldmamisc";
		interrupts = <0x0 0x6d 0x4>;
		reg = <0x0 0x1021b800 0x0 0x100>;
	};

	apcldmamisc_ao@10014800 {
		compatible = "mediatek,apcldmamisc_ao";
		reg = <0x0 0x10014800 0x0 0x400>;
	};

	apcldmamisc_ao@10014c00 {
		compatible = "mediatek,apcldmamisc_ao";
		reg = <0x0 0x10014c00 0x0 0x400>;
	};

	apcldmaout@1021b400 {
		compatible = "mediatek,apcldmaout";
		reg = <0x0 0x1021b400 0x0 0x100>;
	};

	apcldmaout_ao@10014400 {
		compatible = "mediatek,apcldmaout_ao";
		reg = <0x0 0x10014400 0x0 0x400>;
	};

	apirq@1000b000 {
		compatible = "mediatek,apirq";
		interrupts = <0x0 0x73 0x4>;
		reg = <0x0 0x1000b000 0x0 0x1000>;
	};

	apmixed@1000c000 {
		#clock-cells = <0x1>;
		compatible = "mediatek,mt6761-apmixedsys", "syscon";
		phandle = <0x20>;
		reg = <0x0 0x1000c000 0x0 0xe00>;
	};

	atf_logger {
		compatible = "mediatek,atf_logger";
		interrupts = <0x0 0x4e 0x1>;
	};

	audclk@11220000 {
		#clock-cells = <0x1>;
		compatible = "mediatek,mt6761-audsys", "syscon";
		phandle = <0x58>;
		reg = <0x0 0x11220000 0x0 0x1000>;
	};

	audio@11220000 {
		compatible = "mediatek,audio", "syscon";
		mediatek,btcvsd_snd = <0x57>;
		phandle = <0xdc>;
		reg = <0x0 0x11220000 0x0 0x1000>;
	};

	audio_snd_card {
		compatible = "mediatek,audio_snd_card";
	};

	audio_sram@11221000 {
		compatible = "mediatek,audio_sram";
		reg = <0x0 0x11221000 0x0 0x9000>;
	};

	auxadc@11001000 {
		#interconnect-cells = <0x1>;
		#io-channel-cells = <0x1>;
		clock-names = "main";
		clocks = <0x22 0x21>;
		compatible = "mediatek,mt6765-auxadc";
		interrupts = <0x0 0x14 0x2>;
		mediatek,cali-efuse-reg-offset = <0x1a8>;
		mediatek,cali-en-bit = <0x14>;
		mediatek,cali-ge-bit = <0xa>;
		mediatek,cali-oe-bit = <0x0>;
		nvmem = <0x44>;
		nvmem-names = "mtk_efuse";
		phandle = <0x36>;
		reg = <0x0 0x11001000 0x0 0x1000>;
	};

	battery {
		compatible = "mediatek,bat_gm30";
		phandle = <0xfd>;
	};

	bpi_bsi_slv0@1021e000 {
		compatible = "mediatek,bpi_bsi_slv0";
		reg = <0x0 0x1021e000 0x0 0x1000>;
	};

	bpi_bsi_slv1@1021f000 {
		compatible = "mediatek,bpi_bsi_slv1";
		reg = <0x0 0x1021f000 0x0 0x6000>;
	};

	bpi_bsi_slv2@10225000 {
		compatible = "mediatek,bpi_bsi_slv2";
		reg = <0x0 0x10225000 0x0 0x1000>;
	};

	btif@1100c000 {
		clock-names = "btifc", "apdmac";
		clocks = <0x22 0x1a 0x22 0x26>;
		compatible = "mediatek,btif";
		interrupts = <0x0 0x38 0x8 0x0 0x4c 0x8 0x0 0x4d 0x8>;
		reg = <0x0 0x1100c000 0x0 0x1000 0x0 0x11000880 0x0 0x80 0x0 0x11000900 0x0 0x80>;
	};

	bus_dbg@10208000 {
		compatible = "mediatek,bus_dbg-v2";
		interrupts = <0x0 0x55 0x8>;
		mediatek,bus_dbg_con_offset = <0x2fc>;
		reg = <0x0 0x10208000 0x0 0x1000 0x0 0x10001000 0x0 0x1000>;
	};

	cam@15004000 {
		compatible = "mediatek,cam";
		reg = <0x0 0x15004000 0x0 0x1000>;
	};

	cam_dma@15007000 {
		compatible = "mediatek,cam_dma";
		reg = <0x0 0x15007000 0x0 0x1000>;
	};

	cam_inner@1500d000 {
		compatible = "mediatek,cam_inner";
		reg = <0x0 0x1500d000 0x0 0x1000>;
	};

	cam_inner_dma@1500f000 {
		compatible = "mediatek,cam_inner_dma";
		reg = <0x0 0x1500f000 0x0 0x1000>;
	};

	cam_lut@15005000 {
		compatible = "mediatek,cam_lut";
		reg = <0x0 0x15005000 0x0 0x1000>;
	};

	camd@15006000 {
		compatible = "mediatek,camd";
		reg = <0x0 0x15006000 0x0 0x1000>;
	};

	camd_inner@1500e000 {
		compatible = "mediatek,camd_inner";
		reg = <0x0 0x1500e000 0x0 0x1000>;
	};

	camera_af_hw_node {
		camaf_m1_pmic-supply = <0x71>;
		compatible = "mediatek,camera_af_lens";
		phandle = <0xec>;
	};

	camsv0@15050000 {
		compatible = "mediatek,camsv0";
		reg = <0x0 0x15050000 0x0 0x1000>;
	};

	camsv1@15051000 {
		compatible = "mediatek,camsv1";
		reg = <0x0 0x15051000 0x0 0x1000>;
	};

	camsys@15000000 {
		#clock-cells = <0x1>;
		compatible = "mediatek,mt6761-camsys", "syscon";
		phandle = <0x11>;
		reg = <0x0 0x15000000 0x0 0x1000>;
	};

	ccifdriver@10209000 {
		clock-names = "infra-ccif-ap", "infra-ccif-md", "infra-ccif1-ap", "infra-ccif1-md", "infra-ccif2-ap", "infra-ccif2-md";
		clocks = <0x22 0x29 0x22 0x2c 0x22 0x23 0x22 0x24 0x22 0x58 0x22 0x59>;
		compatible = "mediatek,ccci_ccif";
		interrupts = <0x0 0x5c 0x8 0x0 0x5d 0x8>;
		mediatek,sram_size = <0x200>;
		phandle = <0xbb>;
		reg = <0x0 0x10209000 0x0 0x1000 0x0 0x1020a000 0x0 0x1000>;
	};

	charger {
		ac_charger_current = <0x137478>;
		ac_charger_input_current = <0x30d400>;
		algorithm_name = "Basic";
		battery_cv = <0x432380>;
		bootmode = <0x26>;
		charger = <0x25>;
		charger_configuration = <0x0>;
		charging_host_charger_current = <0xf4240>;
		compatible = "mediatek,charger";
		enable_dynamic_mivr;
		enable_min_charge_temp;
		enable_sw_jeita;
		gauge = <0x7a>;
		jeita_temp_above_t4_cv = <0x3e8fa0>;
		jeita_temp_below_t0_cv = <0x432380>;
		jeita_temp_t0_to_t1_cv = <0x432380>;
		jeita_temp_t1_to_t2_cv = <0x432380>;
		jeita_temp_t2_to_t3_cv = <0x432380>;
		jeita_temp_t3_to_t4_cv = <0x3e8fa0>;
		max_charge_temp = <0x3c>;
		max_charge_temp_minus_x_degree = <0x39>;
		max_charger_voltage = <0x632ea0>;
		max_dmivr_charger_current = <0x1b7740>;
		min_charge_temp = <0x0>;
		min_charge_temp_plus_x_degree = <0x3>;
		min_charger_voltage = <0x4630c0>;
		min_charger_voltage_1 = <0x432380>;
		min_charger_voltage_2 = <0x401640>;
		phandle = <0x2a>;
		pmic = <0x2b>;
		temp_neg_10_thres = <0x0>;
		temp_t0_thres = <0x0>;
		temp_t0_thres_plus_x_degree = <0x0>;
		temp_t1_thres = <0x0>;
		temp_t1_thres_plus_x_degree = <0x3>;
		temp_t2_thres = <0xf>;
		temp_t2_thres_plus_x_degree = <0x12>;
		temp_t3_thres = <0x2d>;
		temp_t3_thres_minus_x_degree = <0x2a>;
		temp_t4_thres = <0x37>;
		temp_t4_thres_minus_x_degree = <0x34>;
		usb_charger_current = <0x7a120>;
	};

	chipid@08000000 {
		compatible = "mediatek,chipid";
		reg = <0x0 0x8000000 0x0 0x4 0x0 0x8000004 0x0 0x4 0x0 0x8000008 0x0 0x4 0x0 0x800000c 0x0 0x4>;
	};

	chosen {
		bootargs = "console=tty0 console=ttyS0,921600n1 vmalloc=400M slub_debug=OFZPU page_owner=on swiotlb=noforce cgroup.memory=nosocket,nokmem androidboot.hardware=mt6761 maxcpus=8 loop.max_part=7 firmware_class.path=/vendor/firmware";
		kaslr-seed = <0x0 0x0>;
		phandle = <0x26>;
	};

	cldmadriver@10014000 {
		cldma-infracfg = <0x22>;
		clock-names = "infra-cldma-bclk";
		clocks = <0x22 0x32>;
		compatible = "mediatek,ccci_cldma";
		interrupts = <0x0 0x6d 0x4>;
		mediatek,cldma_capability = <0x6>;
		mediatek,md_generation = <0x1895>;
		mediatek,platform = <0x1a69>;
		phandle = <0xbc>;
		reg = <0x0 0x10014000 0x0 0x1000 0x0 0x1021b000 0x0 0x1000>;
	};

	clocks {

		clk13m {
			#clock-cells = <0x0>;
			clock-frequency = <0xc65d40>;
			compatible = "fixed-clock";
			phandle = <0x2f>;
		};

		clk26m {
			#clock-cells = <0x0>;
			clock-frequency = <0x18cba80>;
			compatible = "fixed-clock";
			phandle = <0x21>;
		};

		clk32k {
			#clock-cells = <0x0>;
			clock-frequency = <0x7d00>;
			compatible = "fixed-clock";
			phandle = <0x92>;
		};
	};

	cm_mgr@10200000 {
		cm_mgr,cp_down = <0x64 0x64>;
		cm_mgr,cp_up = <0x64 0x64>;
		cm_mgr,dt_down = <0x0 0x3>;
		cm_mgr,dt_up = <0x0 0x3>;
		cm_mgr,vp_down = <0x64 0x64>;
		cm_mgr,vp_up = <0x64 0x64>;
		cm_mgr_cpu_opp_to_dram = <0x0 0x0 0x0 0x0 0x1 0x1 0x1 0x1 0x1 0x2 0x2 0x2 0x2 0x2 0x2 0x2>;
		compatible = "mediatek,mt6761-cm_mgr";
		phandle = <0x100>;
		reg = <0x0 0x10200000 0x0 0x4000>;
		reg-names = "cm_mgr_base";
		required-opps = <0x2c 0x2d 0x2e>;
		use_cpu_to_dram_map = "enable";
	};

	consys@18002000 {
		#address-cells = <0x2>;
		#size-cells = <0x2>;
		clock-names = "conn";
		clocks = <0x33 0x1>;
		compatible = "mediatek,mt6761-consys";
		interrupts = <0x0 0xd3 0x8 0x0 0xd5 0x8 0x0 0xd6 0x1>;
		memory-region = <0x48>;
		phandle = <0x14>;
		pmic = <0x2b>;
		reg = <0x0 0x18002000 0x0 0x1000 0x0 0x10007000 0x0 0x100 0x0 0x10001000 0x0 0x1000 0x0 0x10006000 0x0 0x1000 0x0 0x18007000 0x0 0x1000 0x0 0x180b1000 0x0 0x1000 0x0 0x180a3000 0x0 0x1000 0x0 0x180a5000 0x0 0x800 0x0 0x180c1000 0x0 0x1000 0x0 0x18004000 0x0 0x1000>;
	};

	cpu_dbgapb@0d410000 {
		compatible = "mediatek,hw_dbg";
		num = <0x8>;
		phandle = <0x85>;
		reg = <0x0 0xd410000 0x0 0x1000 0x0 0xd510000 0x0 0x1000 0x0 0xd610000 0x0 0x1000 0x0 0xd710000 0x0 0x1000 0x0 0xd810000 0x0 0x1000 0x0 0xd910000 0x0 0x1000 0x0 0xda10000 0x0 0x1000 0x0 0xdb10000 0x0 0x1000>;
	};

	cpus {
		#address-cells = <0x1>;
		#size-cells = <0x0>;

		cpu-map {

			cluster0 {

				core0 {
					cpu = <0xa>;
				};

				core1 {
					cpu = <0xb>;
				};

				core2 {
					cpu = <0xc>;
				};

				core3 {
					cpu = <0xd>;
				};
			};
		};

		cpu@000 {
			capacity-dmips-mhz = <0x400>;
			clock-frequency = <0x8b799100>;
			compatible = "arm,cortex-a53";
			cpu-idle-states = <0x3 0x4 0x5 0x6 0x7 0x8 0x9>;
			device_type = "cpu";
			dynamic-power-coefficient = <0x113>;
			enable-method = "psci";
			operating-points-v2 = <0x2>;
			phandle = <0xa>;
			reg = <0x0>;
		};

		cpu@001 {
			capacity-dmips-mhz = <0x400>;
			clock-frequency = <0x8b799100>;
			compatible = "arm,cortex-a53";
			cpu-idle-states = <0x3 0x4 0x5 0x6 0x7 0x8 0x9>;
			device_type = "cpu";
			dynamic-power-coefficient = <0x113>;
			enable-method = "psci";
			operating-points-v2 = <0x2>;
			phandle = <0xb>;
			reg = <0x1>;
		};

		cpu@002 {
			capacity-dmips-mhz = <0x400>;
			clock-frequency = <0x8b799100>;
			compatible = "arm,cortex-a53";
			cpu-idle-states = <0x3 0x4 0x5 0x6 0x7 0x8 0x9>;
			device_type = "cpu";
			dynamic-power-coefficient = <0x113>;
			enable-method = "psci";
			operating-points-v2 = <0x2>;
			phandle = <0xc>;
			reg = <0x2>;
		};

		cpu@003 {
			capacity-dmips-mhz = <0x400>;
			clock-frequency = <0x8b799100>;
			compatible = "arm,cortex-a53";
			cpu-idle-states = <0x3 0x4 0x5 0x6 0x7 0x8 0x9>;
			device_type = "cpu";
			dynamic-power-coefficient = <0x113>;
			enable-method = "psci";
			operating-points-v2 = <0x2>;
			phandle = <0xd>;
			reg = <0x3>;
		};

		idle-states {
			entry-method = "arm,psci";

			dpidle {
				arm,psci-suspend-param = <0x1010004>;
				compatible = "arm,idle-state";
				entry-latency-us = <0x320>;
				exit-latency-us = <0x3e8>;
				min-residency-us = <0x7d0>;
				phandle = <0x8>;
			};

			mcdi-cluster {
				arm,psci-suspend-param = <0x1010001>;
				compatible = "arm,idle-state";
				entry-latency-us = <0x258>;
				exit-latency-us = <0x258>;
				min-residency-us = <0x4b0>;
				phandle = <0x5>;
			};

			mcdi-cpu {
				arm,psci-suspend-param = <0x10001>;
				compatible = "arm,idle-state";
				entry-latency-us = <0x258>;
				exit-latency-us = <0x258>;
				min-residency-us = <0x4b0>;
				phandle = <0x4>;
			};

			sodi {
				arm,psci-suspend-param = <0x1010002>;
				compatible = "arm,idle-state";
				entry-latency-us = <0x320>;
				exit-latency-us = <0x3e8>;
				min-residency-us = <0x7d0>;
				phandle = <0x6>;
			};

			sodi3 {
				arm,psci-suspend-param = <0x1010003>;
				compatible = "arm,idle-state";
				entry-latency-us = <0x320>;
				exit-latency-us = <0x3e8>;
				min-residency-us = <0x7d0>;
				phandle = <0x7>;
			};

			standby {
				arm,psci-suspend-param = <0x1>;
				compatible = "arm,idle-state";
				entry-latency-us = <0x258>;
				exit-latency-us = <0x258>;
				min-residency-us = <0x4b0>;
				phandle = <0x3>;
			};

			suspend {
				arm,psci-suspend-param = <0x1010005>;
				compatible = "arm,idle-state";
				entry-latency-us = <0x320>;
				exit-latency-us = <0x3e8>;
				min-residency-us = <0x7d0>;
				phandle = <0x9>;
			};
		};
	};

	cq_dma@10212000 {
		clock-names = "cqdma";
		clocks = <0x22 0x43>;
		compatible = "mediatek,mt-cqdma-v1";
		interrupts = <0x0 0x39 0x8 0x0 0x3a 0x8 0x0 0x3b 0x8>;
		keep_clock_ao = "yes";
		nr_channel = <0x3>;
		reg = <0x0 0x10212000 0x0 0x80 0x0 0x10212080 0x0 0x80 0x0 0x10212100 0x0 0x68>;
	};

	dbg_apmcu_mp0@0d400000 {
		compatible = "mediatek,dbg_apmcu_mp0";
		reg = <0x0 0xd400000 0x0 0x1000>;
	};

	dbg_apmcu_mp0@0d410000 {
		compatible = "mediatek,dbg_apmcu_mp0";
		reg = <0x0 0xd410000 0x0 0x1000>;
	};

	dbg_apmcu_mp0@0d420000 {
		compatible = "mediatek,dbg_apmcu_mp0";
		reg = <0x0 0xd420000 0x0 0x1000>;
	};

	dbg_apmcu_mp0@0d430000 {
		compatible = "mediatek,dbg_apmcu_mp0";
		reg = <0x0 0xd430000 0x0 0x1000>;
	};

	dbg_apmcu_mp0@0d440000 {
		compatible = "mediatek,dbg_apmcu_mp0";
		reg = <0x0 0xd440000 0x0 0x1000>;
	};

	dbg_apmcu_mp0@0d510000 {
		compatible = "mediatek,dbg_apmcu_mp0";
		reg = <0x0 0xd510000 0x0 0x1000>;
	};

	dbg_apmcu_mp0@0d520000 {
		compatible = "mediatek,dbg_apmcu_mp0";
		reg = <0x0 0xd520000 0x0 0x1000>;
	};

	dbg_apmcu_mp0@0d530000 {
		compatible = "mediatek,dbg_apmcu_mp0";
		reg = <0x0 0xd530000 0x0 0x1000>;
	};

	dbg_apmcu_mp0@0d540000 {
		compatible = "mediatek,dbg_apmcu_mp0";
		reg = <0x0 0xd540000 0x0 0x1000>;
	};

	dbg_apmcu_mp0@0d610000 {
		compatible = "mediatek,dbg_apmcu_mp0";
		reg = <0x0 0xd610000 0x0 0x1000>;
	};

	dbg_apmcu_mp0@0d620000 {
		compatible = "mediatek,dbg_apmcu_mp0";
		reg = <0x0 0xd620000 0x0 0x1000>;
	};

	dbg_apmcu_mp0@0d630000 {
		compatible = "mediatek,dbg_apmcu_mp0";
		reg = <0x0 0xd630000 0x0 0x1000>;
	};

	dbg_apmcu_mp0@0d640000 {
		compatible = "mediatek,dbg_apmcu_mp0";
		reg = <0x0 0xd640000 0x0 0x1000>;
	};

	dbg_apmcu_mp0@0d710000 {
		compatible = "mediatek,dbg_apmcu_mp0";
		reg = <0x0 0xd710000 0x0 0x1000>;
	};

	dbg_apmcu_mp0@0d720000 {
		compatible = "mediatek,dbg_apmcu_mp0";
		reg = <0x0 0xd720000 0x0 0x1000>;
	};

	dbg_apmcu_mp0@0d730000 {
		compatible = "mediatek,dbg_apmcu_mp0";
		reg = <0x0 0xd730000 0x0 0x1000>;
	};

	dbg_apmcu_mp0@0d740000 {
		compatible = "mediatek,dbg_apmcu_mp0";
		reg = <0x0 0xd740000 0x0 0x1000>;
	};

	dbg_apmcu_mp1@0d800000 {
		compatible = "mediatek,dbg_apmcu_mp1";
		reg = <0x0 0xd800000 0x0 0x1000>;
	};

	dbg_apmcu_mp1@0d810000 {
		compatible = "mediatek,dbg_apmcu_mp1";
		reg = <0x0 0xd810000 0x0 0x1000>;
	};

	dbg_apmcu_mp1@0d820000 {
		compatible = "mediatek,dbg_apmcu_mp1";
		reg = <0x0 0xd820000 0x0 0x1000>;
	};

	dbg_apmcu_mp1@0d830000 {
		compatible = "mediatek,dbg_apmcu_mp1";
		reg = <0x0 0xd830000 0x0 0x1000>;
	};

	dbg_apmcu_mp1@0d840000 {
		compatible = "mediatek,dbg_apmcu_mp1";
		reg = <0x0 0xd840000 0x0 0x1000>;
	};

	dbg_apmcu_mp1@0d910000 {
		compatible = "mediatek,dbg_apmcu_mp1";
		reg = <0x0 0xd910000 0x0 0x1000>;
	};

	dbg_apmcu_mp1@0d920000 {
		compatible = "mediatek,dbg_apmcu_mp1";
		reg = <0x0 0xd920000 0x0 0x1000>;
	};

	dbg_apmcu_mp1@0d930000 {
		compatible = "mediatek,dbg_apmcu_mp1";
		reg = <0x0 0xd930000 0x0 0x1000>;
	};

	dbg_apmcu_mp1@0d940000 {
		compatible = "mediatek,dbg_apmcu_mp1";
		reg = <0x0 0xd940000 0x0 0x1000>;
	};

	dbg_apmcu_mp1@0da10000 {
		compatible = "mediatek,dbg_apmcu_mp1";
		reg = <0x0 0xda10000 0x0 0x1000>;
	};

	dbg_apmcu_mp1@0da20000 {
		compatible = "mediatek,dbg_apmcu_mp1";
		reg = <0x0 0xda20000 0x0 0x1000>;
	};

	dbg_apmcu_mp1@0da30000 {
		compatible = "mediatek,dbg_apmcu_mp1";
		reg = <0x0 0xda30000 0x0 0x1000>;
	};

	dbg_apmcu_mp1@0da40000 {
		compatible = "mediatek,dbg_apmcu_mp1";
		reg = <0x0 0xda40000 0x0 0x1000>;
	};

	dbg_apmcu_mp1@0db10000 {
		compatible = "mediatek,dbg_apmcu_mp1";
		reg = <0x0 0xdb10000 0x0 0x1000>;
	};

	dbg_apmcu_mp1@0db20000 {
		compatible = "mediatek,dbg_apmcu_mp1";
		reg = <0x0 0xdb20000 0x0 0x1000>;
	};

	dbg_apmcu_mp1@0db30000 {
		compatible = "mediatek,dbg_apmcu_mp1";
		reg = <0x0 0xdb30000 0x0 0x1000>;
	};

	dbg_apmcu_mp1@0db40000 {
		compatible = "mediatek,dbg_apmcu_mp1";
		reg = <0x0 0xdb40000 0x0 0x1000>;
	};

	dbg_cti@0d020000 {
		compatible = "mediatek,dbg_cti";
		reg = <0x0 0xd020000 0x0 0x10000>;
	};

	dbg_dem@0d0a0000 {
		compatible = "mediatek,dbg_dem";
		interrupts = <0x0 0x54 0x8>;
		reg = <0x0 0xd0a0000 0x0 0x10000>;
	};

	dbg_etr@0d030000 {
		compatible = "mediatek,dbg_etr";
		reg = <0x0 0xd030000 0x0 0x10000>;
	};

	dbg_funnel@0d040000 {
		compatible = "mediatek,dbg_funnel";
		reg = <0x0 0xd040000 0x0 0x10000>;
	};

	dbg_mdsys1@0d0c0000 {
		compatible = "mediatek,dbg_mdsys1";
		reg = <0x0 0xd0c0000 0x0 0x40000>;
	};

	dcm@10001000 {
		compatible = "mediatek,mt6761-dcm";
		phandle = <0x87>;
		reg = <0x0 0x10001000 0x0 0x1000 0x0 0x10200000 0x0 0x4000 0x0 0x10228000 0x0 0x2000 0x0 0x1022a000 0x0 0x2000 0x0 0x10230000 0x0 0x2000 0x0 0x10232000 0x0 0x2000 0x0 0x1022d000 0x0 0x1000 0x0 0x10235000 0x0 0x1000>;
		reg-names = "infra_ao", "mcucfg", "ddrphy0_ao", "dramc0_ao", "ddrphy1_ao", "dramc1_ao", "emi_ch0", "emi_ch1";
	};

	devapc@10207000 {
		clock-names = "devapc-infra-clock";
		clocks = <0x22 0x28>;
		compatible = "mediatek,devapc";
		interrupts = <0x0 0x56 0x8>;
		reg = <0x0 0x10207000 0x0 0x1000>;
	};

	dfd@10200b00 {
		compatible = "mediatek,dfd";
		mediatek,chain_length = <0x61a8>;
		mediatek,check_dfd_support = <0x1>;
		mediatek,dfd_ap_addr_offset = <0x18>;
		mediatek,dfd_infra_base = <0x390>;
		mediatek,dfd_latch_offset = <0x48>;
		mediatek,enabled = <0x1>;
		mediatek,rg_dfd_timeout = <0xa0>;
		reg = <0x0 0x10200b00 0x0 0x10000>;
		reg_base = <0x43>;
	};

	disp_aal0@14011000 {
		compatible = "mediatek,disp_aal0";
		interrupts = <0x0 0xa6 0x8>;
		reg = <0x0 0x14011000 0x0 0x1000>;
	};

	disp_ccorr0@14010000 {
		compatible = "mediatek,disp_ccorr0";
		interrupts = <0x0 0xa5 0x8>;
		reg = <0x0 0x14010000 0x0 0x1000>;
	};

	disp_color0@1400f000 {
		compatible = "mediatek,disp_color0";
		interrupts = <0x0 0xa4 0x8>;
		phandle = <0x3f>;
		reg = <0x0 0x1400f000 0x0 0x1000>;
	};

	disp_dither0@14013000 {
		compatible = "mediatek,disp_dither0";
		interrupts = <0x0 0xa8 0x8>;
		reg = <0x0 0x14013000 0x0 0x1000>;
	};

	disp_gamma0@14012000 {
		compatible = "mediatek,disp_gamma0";
		interrupts = <0x0 0xa7 0x8>;
		reg = <0x0 0x14012000 0x0 0x1000>;
	};

	disp_mutex0@14001000 {
		compatible = "mediatek,disp_mutex0";
		interrupts = <0x0 0x9a 0x8>;
		phandle = <0x41>;
		reg = <0x0 0x14001000 0x0 0x1000>;
	};

	disp_ovl0@1400b000 {
		compatible = "mediatek,disp_ovl0";
		interrupts = <0x0 0xa1 0x8>;
		reg = <0x0 0x1400b000 0x0 0x1000>;
	};

	disp_ovl0_2l@1400c000 {
		compatible = "mediatek,disp_ovl0_2l";
		interrupts = <0x0 0xad 0x8>;
		reg = <0x0 0x1400c000 0x0 0x1000>;
	};

	disp_pwm@1100e000 {
		compatible = "mediatek,disp_pwm";
		reg = <0x0 0x1100e000 0x0 0x1000>;
	};

	disp_rdma0@1400d000 {
		compatible = "mediatek,disp_rdma0";
		interrupts = <0x0 0xa2 0x8>;
		reg = <0x0 0x1400d000 0x0 0x1000>;
	};

	disp_rsz0@14015000 {
		compatible = "mediatek,disp_rsz0";
		interrupts = <0x0 0xdc 0x8>;
		reg = <0x0 0x14015000 0x0 0x1000>;
	};

	disp_wdma0@1400e000 {
		compatible = "mediatek,disp_wdma0";
		interrupts = <0x0 0xa3 0x8>;
		reg = <0x0 0x1400e000 0x0 0x1000>;
	};

	dispsys {
		clock-names = "MMSYS_MTCMOS", "MMSYS_SMI_COMMON", "MMSYS_SMI_LARB0", "MMSYS_GALS_COMM0", "MMSYS_GALS_COMM1", "MMSYS_DISP_OVL0", "MMSYS_DISP_OVL0_2L", "MMSYS_DISP_RDMA0", "MMSYS_DISP_WDMA0", "MMSYS_DISP_COLOR0", "MMSYS_DISP_CCORR0", "MMSYS_DISP_AAL0", "MMSYS_DISP_GAMMA0", "MMSYS_DISP_DITHER0", "MMSYS_DSI0_MM_CK", "MMSYS_DSI0_IF_CK", "MMSYS_26M", "MMSYS_DISP_RSZ0", "APMIXED_MIPI_26M", "TOP_MUX_DISP_PWM", "DISP_PWM", "TOP_26M", "TOP_UNIVPLL2_D4", "TOP_ULPOSC1_D2", "TOP_ULPOSC1_D8";
		clocks = <0x33 0x3 0x10 0x13 0x10 0x14 0x10 0x15 0x10 0x16 0x10 0x7 0x10 0x8 0x10 0xa 0x10 0xb 0x10 0xc 0x10 0xd 0x10 0xe 0x10 0xf 0x10 0x10 0x10 0x11 0x10 0x1c 0x10 0x1d 0x10 0x9 0x20 0x13 0xf 0x7c 0x22 0x31 0x21 0xf 0x1e 0xf 0x2f 0xf 0x31>;
		compatible = "mediatek,dispsys";
		mediatek,larb = <0x30>;
	};

	dispsys_config@14000000 {
		clock-names = "CAM_MDP", "IMG_DL_RELAY", "IMG_DL_ASYNC_TOP";
		clocks = <0x10 0x17 0x10 0x1a 0x10 0x1b>;
		compatible = "mediatek,mmsys_config", "syscon";
		interrupts = <0x0 0xab 0x8>;
		phandle = <0x38>;
		reg = <0x0 0x14000000 0x0 0x1000>;
	};

	dma-controller@11000580 {
		#dma-cells = <0x1>;
		clock-names = "apdma";
		clocks = <0x22 0x26>;
		compatible = "mediatek,mt6577-uart-dma";
		dma-bits = <0x22>;
		dma-requests = <0x4>;
		interrupts = <0x0 0x35 0x8 0x0 0x36 0x8 0x0 0x37 0x8 0x0 0x3c 0x8>;
		phandle = <0x45>;
		reg = <0x0 0x11000680 0x0 0x80 0x0 0x11000700 0x0 0x80 0x0 0x11000780 0x0 0x80 0x0 0x11000800 0x0 0x80>;
	};

	dram_ctrl {
		compatible = "mediatek,dram-qosctrl";
		required-opps = <0x2c 0x2d>;
	};

	dramc@1022a000 {
		compatible = "mediatek,dramc";
		reg = <0x0 0x1022a000 0x0 0x2000 0x0 0x10232000 0x0 0x2000 0x0 0x1022c000 0x0 0x1000 0x0 0x10234000 0x0 0x1000 0x0 0x10228000 0x0 0x2000 0x0 0x10230000 0x0 0x2000 0x0 0x1022e000 0x0 0x1000 0x0 0x10236000 0x0 0x1000>;
	};

	dsi0@14014000 {
		compatible = "mediatek,dsi0";
		interrupts = <0x0 0xa9 0x8>;
		reg = <0x0 0x14014000 0x0 0x1000>;
	};

	dsi_te {
		compatible = "mediatek, DSI_TE-eint";
		phandle = <0xe9>;
		status = "disabled";
	};

	dvfsp@00110800 {
		compatible = "mediatek,mt6761-dvfsp";
		nvmem-cell-names = "efuse_segment_cell";
		nvmem-cells = <0x37>;
		reg = <0x0 0x110800 0x0 0x1400 0x0 0x110800 0x0 0x1400>;
	};

	dvfsp@10227000 {
		compatible = "mediatek,dvfsp";
		reg = <0x0 0x10227000 0x0 0x1000>;
	};

	dvfsrc@10012000 {
		#address-cells = <0x2>;
		#size-cells = <0x2>;
		compatible = "mediatek,mt6761-dvfsrc";
		phandle = <0xb8>;
		ranges;
		reg = <0x0 0x10012000 0x0 0x1000 0x0 0x10006000 0x0 0x1000>;
		reg-names = "dvfsrc", "spm";

		dvfsrc-debug {
			compatible = "mediatek,mt6761-dvfsrc-debug";
			required-opps = <0x2c 0x2d 0x2e>;
		};

		dvfsrc-met {
			compatible = "mediatek,mt6761-dvfsrc-met";
		};

		dvfsrc-up {
			compatible = "mediatek,mt6761-dvfsrc-up";
		};

		opp0 {
			opp-level = <0x0>;
			phandle = <0x2c>;
		};

		opp1 {
			opp-level = <0x1>;
			phandle = <0x2d>;
		};

		opp2 {
			opp-level = <0x2>;
			phandle = <0x2e>;
		};

		qos@00110780 {
			compatible = "mediatek,mt6761-qos";
			reg = <0x0 0x110780 0x0 0x80>;
		};
	};

	dxcc_sec@10210000 {
		compatible = "mediatek,dxcc_sec";
		interrupts = <0x0 0x6a 0x4>;
		reg = <0x0 0x10210000 0x0 0x1000>;
	};

	dynamic_options {
		compatible = "mediatek,dynamic_options";
		phandle = <0xff>;
	};

	eem_fsm@1100b000 {
		compatible = "mediatek,eem_fsm";
		interrupts = <0x0 0x45 0x8>;
		nvmem = <0x44>;
		nvmem-cell-names = "efuse_segment_cell";
		nvmem-cells = <0x37>;
		nvmem-names = "mtk_efuse";
		reg = <0x0 0x1100b000 0x0 0x1000>;
	};

	efuse@11c50000 {
		#address-cells = <0x1>;
		#size-cells = <0x1>;
		compatible = "mediatek,devinfo";
		phandle = <0x44>;
		reg = <0x0 0x11c50000 0x0 0x10000>;

		efuse_analog7@1ac {
			phandle = <0x4a>;
			reg = <0x1ac 0x4>;
		};

		segment@190 {
			phandle = <0x47>;
			reg = <0x190 0xc>;
		};

		segment@1c {
			phandle = <0x46>;
			reg = <0x1c 0x4>;
		};

		segment@78 {
			phandle = <0x37>;
			reg = <0x78 0x4>;
		};
	};

	efuse_dbg@10004000 {
		compatible = "mediatek,efuse_dbg";
		reg = <0x0 0x10004000 0x0 0x1000>;
	};

	eint@1000b000 {
		compatible = "mediatek,eint";
		phandle = <0x8f>;
		reg = <0x0 0x1000b000 0x0 0x1000>;
	};

	emi@10219000 {
		compatible = "mediatek,emi";
		interrupts = <0x0 0x58 0x8>;
		reg = <0x0 0x10219000 0x0 0x1000 0x0 0x10226000 0x0 0x1000 0x0 0x1022d000 0x0 0x1000 0x0 0x10235000 0x0 0x1000>;
	};

	fdvt@1500b000 {
		clock-names = "FD_CLK_CAM_FDVT";
		clocks = <0x11 0x6>;
		compatible = "mediatek,fdvt";
		interrupts = <0x0 0xb6 0x8>;
		reg = <0x0 0x1500b000 0x0 0x1000>;
	};

	fhctl@1000ce00 {
		compatible = "mediatek,mt6761-fhctl";
		mediatek,apmixed = <0x20>;
		phandle = <0x93>;
		reg = <0x0 0x1000ce00 0x0 0x100>;

		armpll {
			mediatek,fh-cpu-pll;
			mediatek,fh-id = <0x0>;
			mediatek,fh-pll-id = <0x0>;
		};

		mainpll {
			mediatek,fh-id = <0x1>;
			mediatek,fh-pll-id = <0x1>;
		};

		mfgpll {
			mediatek,fh-id = <0x3>;
			mediatek,fh-pll-id = <0x2>;
		};

		mmpll {
			mediatek,fh-id = <0x6>;
			mediatek,fh-pll-id = <0x3>;
		};

		mpll {
			mediatek,fh-id = <0x5>;
			mediatek,fh-pll-id = <0x7>;
		};

		msdcpll {
			mediatek,fh-id = <0x2>;
			mediatek,fh-pll-id = <0x5>;
		};
	};

	fingerprint {
		compatible = "mediatek,goodix-fp";
		phandle = <0xb7>;
	};

	flashlight_core {
		compatible = "mediatek,flashlight_core";
		phandle = <0xed>;
	};

	flashlights_sgm3785_gpio {
		compatible = "mediatek,flashlights_sgm3785_gpio";
		decouple = <0x1>;
		phandle = <0xee>;
		pinctrl-0 = <0x72>;
		pinctrl-1 = <0x73>;
		pinctrl-2 = <0x74>;
		pinctrl-3 = <0x75>;
		pinctrl-4 = <0x76>;
		pinctrl-5 = <0x77>;
		pinctrl-6 = <0x78>;
		pinctrl-names = "flashlight_default", "flashlight_enm_gpio_low", "flashlight_enm_gpio_high", "flashlight_enm_pwm_low", "flashlight_enm_pwm_high", "flashlight_enf_gpio_low", "flashlight_enf_gpio_high";
		status = "okay";

		channel@1 {
			ct = <0x0>;
			part = <0x0>;
			type = <0x0>;
		};

		channel@2 {
			ct = <0x1>;
			part = <0x0>;
			type = <0x0>;
		};
	};

	gce@10238000 {
		ap_dma_base = <0x18010000 0x17 0xffff0000>;
		audio_base = <0x17000000 0x12 0xffff0000>;
		buf_underrun_event_0 = <0x8c>;
		camsv_0_pass1_done = <0x106>;
		camsv_1_pass1_done = <0x107>;
		camsys1_base = <0x180a0000 0x1c 0xffff0000>;
		camsys2_base = <0x180b0000 0x1d 0xffff0000>;
		camsys_base = <0x18080000 0x1b 0xffff0000>;
		clock-names = "GCE", "GCE_TIMER";
		clocks = <0x22 0x9 0x22 0x18>;
		compatible = "mediatek,gce", "syscon";
		conn_peri_base = <0x18820000 0x7 0xffff0000>;
		dip_cq_thread0_frame_done = <0x103>;
		dip_cq_thread1_frame_done = <0x102>;
		dip_cq_thread2_frame_done = <0x101>;
		disp_2l_ovl0_frame_done = <0x1c>;
		disp_2l_ovl0_sof = <0x8>;
		disp_aal0_frame_done = <0x22>;
		disp_aal0_sof = <0xd>;
		disp_ccorr0_frame_done = <0x21>;
		disp_ccorr0_sof = <0xc>;
		disp_color0_frame_done = <0x20>;
		disp_color0_sof = <0xb>;
		disp_dither0_frame_done = <0x24>;
		disp_dither0_sof = <0xf>;
		disp_dither_base = <0x14010000 0x2 0xffff0000>;
		disp_dsi0_frame_done = <0x25>;
		disp_dsi0_sof = <0x10>;
		disp_gamma0_frame_done = <0x23>;
		disp_gamma0_sof = <0xe>;
		disp_ovl0_frame_done = <0x1b>;
		disp_ovl0_frame_rst_done_pusle = <0x98>;
		disp_ovl0_sof = <0x7>;
		disp_pwm0_sof = <0x13>;
		disp_rdma0_frame_done = <0x1e>;
		disp_rdma0_sof = <0x9>;
		disp_rsz0_frame_done = <0x1d>;
		disp_rsz0_sof = <0x11>;
		disp_wdma0_frame_done = <0x1f>;
		disp_wdma0_rst_done = <0x93>;
		disp_wdma0_sof = <0xa>;
		dsi0_done_event = <0x8f>;
		dsi0_irq_event = <0x8e>;
		dsi0_te_event = <0x8d>;
		g3d_config_base = <0x13000000 0x0 0xffff0000>;
		gce_base = <0x18020000 0x18 0xffff0000>;
		gcpu_base = <0x10050000 0xf 0xffff0000>;
		img_dl_relay_sof = <0x12>;
		imgsys_base = <0x15020000 0x4 0xffff0000>;
		infra_na3_base = <0x10010000 0xb 0xffff0000>;
		infra_na4_base = <0x10020000 0xc 0xffff0000>;
		interrupts = <0x0 0x62 0x8>;
		isp_frame_done_p1_0 = <0x105>;
		isp_frame_done_p1_1 = <0x104>;
		jpgdec_done = <0x123>;
		jpgenc_done = <0x122>;
		kp_base = <0x18840000 0x9 0xffff0000>;
		max_prefetch_cnt = <0x1>;
		mboxes = <0x42 0x0 0x0 0x4 0x42 0x1 0x0 0x4 0x42 0x2 0x0 0x5 0x42 0x3 0x0 0x4 0x42 0x4 0x0 0x4 0x42 0x5 0x0 0x4 0x42 0x6 0xc8 0x3 0x42 0x7 0xffffffff 0x2 0x42 0x8 0x0 0x1 0x42 0x9 0x0 0x1 0x42 0xa 0x0 0x1 0x42 0xb 0x0 0x1 0x42 0xc 0x0 0x1 0x42 0xd 0x0 0x1 0x42 0xe 0x0 0x1 0x42 0xf 0x0 0x1>;
		mcucfg_base = <0x10040000 0xe 0xffff0000>;
		mdp_ccorr0 = <0x40>;
		mdp_ccorr0_frame_done = <0x15>;
		mdp_ccorr0_sof = <0x1>;
		mdp_color0 = <0x3f>;
		mdp_rdma0 = <0x39>;
		mdp_rdma0_frame_done = <0x14>;
		mdp_rdma0_rst_done = <0x97>;
		mdp_rdma0_sof = <0x0>;
		mdp_rsz0 = <0x3a>;
		mdp_rsz0_frame_done = <0x16>;
		mdp_rsz0_sof = <0x2>;
		mdp_rsz1 = <0x3b>;
		mdp_rsz1_frame_done = <0x17>;
		mdp_rsz1_sof = <0x3>;
		mdp_tdshp0 = <0x3e>;
		mdp_tdshp0_frame_done = <0x1a>;
		mdp_tdshp0_sof = <0x6>;
		mdp_wdma0 = <0x3c>;
		mdp_wdma_frame_done = <0x19>;
		mdp_wdma_rst_done = <0x94>;
		mdp_wdma_sof = <0x4>;
		mdp_wrot0 = <0x3d>;
		mdp_wrot0_rst_done = <0x95>;
		mdp_wrot0_sof = <0x5>;
		mdp_wrot0_write_frame_done = <0x18>;
		mediatek,mailbox-gce = <0x42>;
		mipitx0_base = <0x11c80000 0x63 0xffff0000>;
		mm_mutex = <0x41>;
		mm_na_base = <0x14020000 0x3 0xffff0000>;
		mmsys_config = <0x38>;
		mmsys_config_base = <0x14000000 0x1 0xffff0000>;
		msdc2_base = <0x17020000 0x14 0xffff0000>;
		msdc3_base = <0x18000000 0x16 0xffff0000>;
		phandle = <0xbe>;
		prefetch_size = <0x60>;
		pwm_sw_base = <0x1100e000 0x63 0xffff0000>;
		reg = <0x0 0x10238000 0x0 0x4000>;
		scp_base = <0x10030000 0xd 0xffff0000>;
		scp_sram_base = <0x10000000 0xa 0xffff0000>;
		secure_thread = <0x8 0xa>;
		seninf_0_fifo_full = <0x108>;
		seninf_1_fifo_full = <0x109>;
		seninf_2_fifo_full = <0x10a>;
		seninf_3_fifo_full = <0x10b>;
		seninf_4_fifo_full = <0x10c>;
		seninf_5_fifo_full = <0x10d>;
		seninf_6_fifo_full = <0x10e>;
		seninf_7_fifo_full = <0x10f>;
		sram_share_cnt = <0x1>;
		sram_share_engine = <0xa>;
		sram_share_event = <0x2c6>;
		sram_size_cpr_64 = <0x40>;
		stream_done_0 = <0x82>;
		stream_done_1 = <0x83>;
		stream_done_2 = <0x84>;
		stream_done_3 = <0x85>;
		stream_done_4 = <0x86>;
		stream_done_5 = <0x87>;
		stream_done_6 = <0x88>;
		stream_done_7 = <0x89>;
		stream_done_8 = <0x8a>;
		stream_done_9 = <0x8b>;
		thread_count = <0x10>;
		topckgen_base = <0x18830000 0x8 0xffff0000>;
		usb0_base = <0x10200000 0x10 0xffff0000>;
		usb_sif_base = <0x10280000 0x11 0xffff0000>;
		vdec1_base = <0x17030000 0x15 0xffff0000>;
		vdec2_base = <0x18040000 0x19 0xffff0000>;
		vdec3_base = <0x18050000 0x1a 0xffff0000>;
		vdec_base = <0x17010000 0x13 0xffff0000>;
		vdec_gcon_base = <0x18800000 0x5 0xffff0000>;
		venc_128byte_cnt_done = <0x125>;
		venc_done = <0x121>;
		venc_gcon_base = <0x18810000 0x6 0xffff0000>;
		venc_mb_done = <0x124>;
	};

	gce_mbox@10238000 {
		#gce-event-cells = <0x1>;
		#gce-subsys-cells = <0x2>;
		#mbox-cells = <0x3>;
		clock-names = "gce", "gce-timer";
		clocks = <0x22 0x9 0x22 0x18>;
		compatible = "mediatek,mt6761-gce";
		default_tokens = [02 bc 02 bd 02 be 02 bf 02 c0 02 c6 02 c7];
		interrupts = <0x0 0x62 0x8>;
		phandle = <0x42>;
		reg = <0x0 0x10238000 0x0 0x4000>;
	};

	ged {
		compatible = "mediatek,ged";
		gpufreq-supply = <0x5a>;
		phandle = <0x59>;
	};

	gic500@0c000000 {
		compatible = "mediatek,gic500";
		reg = <0x0 0xc000000 0x0 0x400000>;
	};

	gic_cpu@0c400000 {
		compatible = "mediatek,gic_cpu";
		reg = <0x0 0xc400000 0x0 0x40000>;
	};

	gpio {
		compatible = "mediatek,gpio_usage_mapping";
		phandle = <0x8d>;
	};

	gpio@10005000 {
		compatible = "mediatek,gpio", "syscon";
		phandle = <0x16>;
		reg = <0x0 0x10005000 0x0 0x1000>;
	};

	gpufreq {
		clock-names = "clk_mux", "clk_main_parent", "clk_sub_parent", "mtcmos_mfg_async", "mtcmos_mfg", "mtcmos_mfg_core0";
		clocks = <0xf 0x6d 0xf 0x28 0x21 0x33 0x7 0x33 0x4 0x33 0x6>;
		compatible = "mediatek,mt6761-gpufreq";
		nvmem-cell-names = "efuse_segment_cell";
		nvmem-cells = <0x37>;
		phandle = <0x5a>;
		vcore-supply = <0x35>;
	};

	hacc@1000a000 {
		compatible = "mediatek,hacc";
		interrupts = <0x0 0x85 0x8>;
		reg = <0x0 0x1000a000 0x0 0x1000>;
	};

	hwrng {
		compatible = "mediatek,mt67xx-rng";
		phandle = <0xba>;
	};

	i2c0@11007000 {
		aed = <0x1a>;
		clock-div = <0x5>;
		clock-names = "main", "dma";
		clocks = <0x22 0xb 0x22 0x26>;
		compatible = "mediatek,i2c";
		eh_cfg = <0x20>;
		gpio_start = <0x10002a00>;
		id = <0x0>;
		interrupts = <0x0 0x1c 0x8>;
		mediatek,hs_only;
		mem_len = <0x200>;
		phandle = <0xc3>;
		pu_cfg = <0x50>;
		reg = <0x0 0x11007000 0x0 0x1000 0x0 0x11000080 0x0 0x80>;
		rsel_cfg = <0x70>;
		scl-gpio-id = <0x53>;
		sda-gpio-id = <0x52>;
	};

	i2c1@11008000 {
		aed = <0x1a>;
		clock-div = <0x5>;
		clock-names = "main", "dma";
		clocks = <0x22 0xb 0x22 0x26>;
		compatible = "mediatek,i2c";
		eh_cfg = <0x20>;
		gpio_start = <0x10002a00>;
		id = <0x1>;
		interrupts = <0x0 0x1d 0x8>;
		mediatek,hs_only;
		mem_len = <0x200>;
		phandle = <0xc4>;
		pu_cfg = <0x50>;
		reg = <0x0 0x11008000 0x0 0x1000 0x0 0x11000100 0x0 0x80>;
		rsel_cfg = <0x70>;
		scl-gpio-id = <0x54>;
		sda-gpio-id = <0x51>;
	};

	i2c2@11009000 {
		aed = <0x1a>;
		ch_offset_ccu = <0x200>;
		ch_offset_default = <0x100>;
		clock-div = <0x5>;
		clock-names = "main", "dma";
		clocks = <0x22 0xb 0x22 0x26>;
		compatible = "mediatek,i2c";
		eh_cfg = <0x20>;
		gpio_start = <0x10002800>;
		id = <0x2>;
		interrupts = <0x0 0x1e 0x8>;
		mediatek,hs_only;
		mem_len = <0x200>;
		phandle = <0xc5>;
		pu_cfg = <0x60>;
		reg = <0x0 0x11009000 0x0 0x1000 0x0 0x11000180 0x0 0x180>;
		rsel_cfg = <0xa0>;
		scl-gpio-id = <0x67>;
		sda-gpio-id = <0x68>;
	};

	i2c3@1100f000 {
		aed = <0x1a>;
		ch_offset_default = <0x100>;
		clock-div = <0x5>;
		clock-names = "main", "dma";
		clocks = <0x22 0xb 0x22 0x26>;
		compatible = "mediatek,i2c";
		eh_cfg = <0x20>;
		gpio_start = <0x10002600>;
		id = <0x3>;
		interrupts = <0x0 0x1f 0x8>;
		mediatek,hs_only;
		mem_len = <0x200>;
		phandle = <0xc6>;
		pu_cfg = <0x90>;
		reg = <0x0 0x1100f000 0x0 0x1000 0x0 0x11000300 0x0 0x100>;
		rsel_cfg = <0xb0>;
		scl-gpio-id = <0x32>;
		sda-gpio-id = <0x33>;
	};

	i2c4@11011000 {
		aed = <0x1a>;
		ch_offset_ccu = <0x200>;
		ch_offset_default = <0x100>;
		clock-div = <0x5>;
		clock-names = "main", "dma";
		clocks = <0x22 0xb 0x22 0x26>;
		compatible = "mediatek,i2c";
		eh_cfg = <0x20>;
		gpio_start = <0x10002800>;
		id = <0x4>;
		interrupts = <0x0 0x20 0x8>;
		mediatek,hs_only;
		mem_len = <0x200>;
		phandle = <0xc7>;
		pu_cfg = <0x60>;
		reg = <0x0 0x11011000 0x0 0x1000 0x0 0x11000400 0x0 0x180>;
		rsel_cfg = <0xa0>;
		scl-gpio-id = <0x69>;
		sda-gpio-id = <0x6a>;
	};

	i2c5@11016000 {
		#address-cells = <0x1>;
		#size-cells = <0x0>;
		aed = <0x1a>;
		clock-div = <0x5>;
		clock-names = "main", "dma";
		clocks = <0x22 0xb 0x22 0x26>;
		compatible = "mediatek,i2c";
		eh_cfg = <0x20>;
		gpio_start = <0x10002600>;
		id = <0x5>;
		interrupts = <0x0 0x4a 0x8>;
		mediatek,hs_only;
		mem_len = <0x200>;
		phandle = <0xc8>;
		pu_cfg = <0x90>;
		reg = <0x0 0x11016000 0x0 0x1000 0x0 0x11000580 0x0 0x80>;
		rsel_cfg = <0xb0>;
		scl-gpio-id = <0x30>;
		sda-gpio-id = <0x31>;

		i2c_lcd_bias@3e {
			compatible = "mediatek,i2c_lcd_bias";
			reg = <0x3e>;
			status = "okay";
		};
	};

	i2c6@1100d000 {
		aed = <0x1a>;
		ch_offset_ccu = <0x200>;
		ch_offset_default = <0x100>;
		clock-div = <0x5>;
		clock-names = "main", "dma";
		clocks = <0x22 0xb 0x22 0x26>;
		compatible = "mediatek,i2c";
		eh_cfg = <0x20>;
		gpio_start = <0x10002c00>;
		id = <0x6>;
		interrupts = <0x0 0x4b 0x8>;
		mediatek,hs_only;
		mem_len = <0x200>;
		phandle = <0xc9>;
		pu_cfg = <0x50>;
		reg = <0x0 0x1100d000 0x0 0x1000 0x0 0x11000600 0x0 0x80>;
		rsel_cfg = <0x70>;
		scl-gpio-id = <0xa1>;
		sda-gpio-id = <0xa2>;
	};

	i2c7 {
		phandle = <0xca>;
	};

	i2c8 {
		phandle = <0xcb>;
	};

	i2c9 {
		phandle = <0xcc>;
	};

	i2c_common {
		check_max_freq = [01];
		cnt_constraint = [01];
		compatible = "mediatek,i2c_common";
		dma_support = [02];
		ext_time_config = [18 01];
		idvfs = [01];
		phandle = <0xc2>;
		set_dt_div = [01];
		set_ltiming = [01];
		ver = [02];
	};

	imp_iic@11017000 {
		compatible = "mediatek,imp_iic";
		reg = <0x0 0x11017000 0x0 0x1000>;
	};

	infra_mbist@1020d000 {
		compatible = "mediatek,infra_mbist";
		reg = <0x0 0x1020d000 0x0 0x1000>;
	};

	infracfg@1020e000 {
		compatible = "mediatek,infracfg";
		reg = <0x0 0x1020e000 0x0 0x1000>;
	};

	infracfg_ao@10001000 {
		#clock-cells = <0x1>;
		compatible = "mediatek,common-infracfg_ao", "mediatek,mt6761-infracfg", "syscon";
		interrupts = <0x0 0x5b 0x1>;
		phandle = <0x22>;
		reg = <0x0 0x10001000 0x0 0x1000>;
	};

	interrupt-controller@0c000000 {
		#address-cells = <0x2>;
		#interrupt-cells = <0x3>;
		#redistributor-regions = <0x1>;
		#size-cells = <0x2>;
		compatible = "arm,gic-v3";
		interrupt-controller;
		interrupt-parent = <0xe>;
		interrupts = <0x1 0x9 0x4>;
		phandle = <0xe>;
		reg = <0x0 0xc000000 0x0 0x40000 0x0 0xc080000 0x0 0x200000 0x0 0x10200a80 0x0 0x50>;
	};

	intpol-controller@10200a80 {
		#interrupt-cells = <0x3>;
		compatible = "mediatek,mt6577-sysirq";
		interrupt-controller;
		interrupt-parent = <0xe>;
		phandle = <0x1>;
		reg = <0x0 0x10200a80 0x0 0x50>;
	};

	io_cfg_bl@10002600 {
		compatible = "mediatek,io_cfg_bl";
		phandle = <0x1a>;
		reg = <0x0 0x10002600 0x0 0x200>;
	};

	io_cfg_lb@10002400 {
		compatible = "mediatek,io_cfg_lb";
		phandle = <0x19>;
		reg = <0x0 0x10002400 0x0 0x200>;
	};

	io_cfg_lm@10002200 {
		compatible = "mediatek,io_cfg_lm";
		phandle = <0x18>;
		reg = <0x0 0x10002200 0x0 0x200>;
	};

	io_cfg_lt@10002000 {
		compatible = "mediatek,io_cfg_lt";
		phandle = <0x17>;
		reg = <0x0 0x10002000 0x0 0x200>;
	};

	io_cfg_rb@10002a00 {
		compatible = "mediatek,io_cfg_rb";
		phandle = <0x1c>;
		reg = <0x0 0x10002a00 0x0 0x200>;
	};

	io_cfg_rr@10002800 {
		compatible = "mediatek,io_cfg_rr";
		phandle = <0x1b>;
		reg = <0x0 0x10002800 0x0 0x200>;
	};

	io_cfg_rt@10002c00 {
		compatible = "mediatek,io_cfg_rt";
		phandle = <0x1d>;
		reg = <0x0 0x10002c00 0x0 0x200>;
	};

	iocfg_0@10002000 {
		compatible = "mediatek,iocfg_0";
		reg = <0x0 0x10002000 0x0 0x200>;
	};

	iocfg_1@10002200 {
		compatible = "mediatek,iocfg_1";
		reg = <0x0 0x10002200 0x0 0x200>;
	};

	iocfg_2@10002400 {
		compatible = "mediatek,iocfg_2";
		reg = <0x0 0x10002400 0x0 0x200>;
	};

	iocfg_3@10002600 {
		compatible = "mediatek,iocfg_3";
		reg = <0x0 0x10002600 0x0 0x200>;
	};

	iocfg_4@10002800 {
		compatible = "mediatek,iocfg_4";
		reg = <0x0 0x10002800 0x0 0x200>;
	};

	iocfg_5@10002a00 {
		compatible = "mediatek,iocfg_5";
		reg = <0x0 0x10002a00 0x0 0x200>;
	};

	irq_nfc {
		compatible = "mediatek,irq_nfc-eint";
		phandle = <0xe6>;
	};

	ispsys@15000000 {
		clock-names = "CG_SCP_SYS_DIS", "CG_SCP_SYS_CAM", "CG_CAM_LARB2", "CG_CAM", "CG_CAMTG", "CG_CAM_SENINF", "CG_CAMSV0", "CG_CAMSV1", "CG_MM_SMI_COMM0", "CG_MM_SMI_COMM1", "CG_MM_SMI_COMMON";
		clocks = <0x33 0x3 0x33 0x8 0x11 0x0 0x11 0x1 0x11 0x2 0x11 0x3 0x11 0x4 0x11 0x5 0x10 0x15 0x10 0x16 0x10 0x13>;
		compatible = "mediatek,mt6761-ispsys";
		interrupts = <0x0 0xb3 0x8 0x0 0xb4 0x8 0x0 0xb5 0x8 0x0 0xb8 0x8 0x0 0xb9 0x8 0x0 0xba 0x8 0x0 0xbb 0x8>;
		reg = <0x0 0x15004000 0x0 0x9000 0x0 0x1500d000 0x0 0x1000 0x0 0x15000000 0x0 0x52000 0x0 0x15040000 0x0 0x8000 0x0 0x10215000 0x0 0x3000 0x0 0x10211000 0x0 0x1000>;
	};

	kd_camera_hw1@15040000 {
		cam0_vcama-supply = <0x6d>;
		cam0_vcamaf-supply = <0x70>;
		cam0_vcamd-supply = <0x6e>;
		cam0_vcamio-supply = <0x6f>;
		cam1_vcama-supply = <0x6d>;
		cam1_vcamd-supply = <0x6e>;
		cam1_vcamio-supply = <0x6f>;
		clock-names = "CLK_TOP_CAMTG_SEL", "CLK_TOP_CAMTG1_SEL", "CLK_TOP_CAMTG2_SEL", "CLK_TOP_CAMTG3_SEL", "CLK_MCLK_6M", "CLK_MCLK_12M", "CLK_MCLK_13M", "CLK_MCLK_48M", "CLK_MCLK_52M", "CLK_MCLK_24M", "CLK_MCLK_26M", "CLK_CAM_SENINF_CG", "CLK_MIPI_C0_26M_CG", "CLK_MIPI_C1_26M_CG", "CLK_MIPI_ANA_0A_CG", "CLK_TOP_CAMTM_SEL_CG", "CLK_TOP_CAMTM_208_CG", "CLK_SCP_SYS_CAM";
		clocks = <0xf 0x6f 0xf 0x70 0xf 0x71 0xf 0x72 0xf 0x16 0xf 0x15 0xf 0x20 0xf 0x13 0xf 0x1f 0xf 0x14 0x21 0x11 0x3 0x20 0xc 0x20 0x10 0x5b 0x0 0xf 0x86 0xf 0x1d 0x33 0x8>;
		compatible = "mediatek,camera_hw";
		phandle = <0xeb>;
		pinctrl-0 = <0x5c>;
		pinctrl-1 = <0x5d>;
		pinctrl-10 = <0x66>;
		pinctrl-11 = <0x67>;
		pinctrl-12 = <0x68>;
		pinctrl-13 = <0x69>;
		pinctrl-14 = <0x6a>;
		pinctrl-15 = <0x6b>;
		pinctrl-16 = <0x6c>;
		pinctrl-2 = <0x5e>;
		pinctrl-3 = <0x5f>;
		pinctrl-4 = <0x60>;
		pinctrl-5 = <0x61>;
		pinctrl-6 = <0x62>;
		pinctrl-7 = <0x63>;
		pinctrl-8 = <0x64>;
		pinctrl-9 = <0x65>;
		pinctrl-names = "default", "cam0_rst0", "cam0_rst1", "cam0_pnd0", "cam0_pnd1", "cam1_rst0", "cam1_rst1", "cam1_pnd0", "cam1_pnd1", "cam0_vcama_on", "cam0_vcama_off", "cam1_vcamd_on", "cam1_vcamd_off", "cam0_mclk_on", "cam0_mclk_off", "cam1_mclk_on", "cam1_mclk_off";
		reg = <0x0 0x15040000 0x0 0x1000>;
		status = "okay";
	};

	kp@10010000 {
		clock-names = "kpd";
		clocks = <0x21>;
		compatible = "mediatek,kp";
		interrupts = <0x0 0x7c 0x2>;
		phandle = <0x13>;
		reg = <0x0 0x10010000 0x0 0x1000>;
	};

	l2c_parity {
		compatible = "mediatek,l2c_parity-v1";
		interrupts = <0x0 0x0 0x4>;
	};

	lcd_bias {
		compatible = "mediatek,gpio_lcd_bias";
		phandle = <0x105>;
		pinctrl-0 = <0x7f>;
		pinctrl-1 = <0x80>;
		pinctrl-2 = <0x81>;
		pinctrl-3 = <0x82>;
		pinctrl-4 = <0x83>;
		pinctrl-names = "default", "lcd_bias_gpio_enp0", "lcd_bias_gpio_enp1", "lcd_bias_gpio_enn0", "lcd_bias_gpio_enn1";
		status = "okay";
	};

	lk_charger {
		ac_charger_current = <0x119bd0>;
		ac_charger_input_current = <0x30d400>;
		charging_host_charger_current = <0xf4240>;
		compatible = "mediatek,lk_charger";
		fast_charge_voltage = <0x2dc6c0>;
		max_charger_voltage = <0x632ea0>;
		non_std_ac_charger_current = <0x7a120>;
		pd_charger_current = <0x7a120>;
		phandle = <0xf3>;
		ta_ac_charger_current = <0x2dc6c0>;
		temp_t1_threshold = <0x0>;
		temp_t2_threshold = <0xf>;
		temp_t3_threshold = <0x2d>;
		temp_t4_threshold = <0x3c>;
		usb_charger_current = <0x7a120>;
	};

	m4u@10205000 {
		#iommu-cells = <0x1>;
		cell-index = <0x0>;
		compatible = "mediatek,iommu_v0";
		interrupts = <0x0 0x9e 0x8>;
		mediatek,larbs = <0x30 0x31 0x32>;
		phandle = <0x7d>;
		reg = <0x0 0x10205000 0x0 0x1000>;
	};

	mbist@17050000 {
		compatible = "mediatek,mbist";
		reg = <0x0 0x17050000 0x0 0x10000>;
	};

	mbist_ao@10013000 {
		compatible = "mediatek,mbist_ao";
		reg = <0x0 0x10013000 0x0 0x1000>;
	};

	mcdi@0010fc00 {
		compatible = "mediatek,mt6761-mcdi";
		reg = <0x0 0x10fc00 0x0 0x800>;
	};

	mcucfg@10200000 {
		compatible = "mediatek,mcucfg";
		interrupts = <0x0 0x0 0x4>;
		reg = <0x0 0x10200000 0x0 0x200>;
	};

	mcucfg@10200200 {
		compatible = "mediatek,mcucfg";
		interrupts = <0x0 0x1 0x8>;
		reg = <0x0 0x10200200 0x0 0x200>;
	};

	mcucfg@10200400 {
		compatible = "mediatek,mcucfg";
		interrupts = <0x0 0x2 0x4>;
		reg = <0x0 0x10200400 0x0 0x200>;
	};

	mcucfg@10200600 {
		compatible = "mediatek,mcucfg";
		interrupts = <0x0 0x3 0x4>;
		reg = <0x0 0x10200600 0x0 0x200>;
	};

	mcucfg@10200800 {
		compatible = "mediatek,mcucfg";
		interrupts = <0x0 0x4 0x4>;
		reg = <0x0 0x10200800 0x0 0x200>;
	};

	mcucfg@10200a00 {
		compatible = "mediatek,mcucfg";
		interrupts = <0x0 0x5 0x8>;
		reg = <0x0 0x10200a00 0x0 0x300>;
	};

	mcucfg@10200f00 {
		compatible = "mediatek,mcucfg";
		interrupts = <0x0 0x6 0x8>;
		reg = <0x0 0x10200f00 0x0 0x100>;
	};

	mcucfg@10201000 {
		compatible = "mediatek,mcucfg";
		interrupts = <0x0 0x7 0x8>;
		reg = <0x0 0x10201000 0x0 0x1000>;
	};

	mcucfg@10202000 {
		compatible = "mediatek,mcucfg";
		interrupts = <0x0 0x8 0x8>;
		reg = <0x0 0x10202000 0x0 0x1000>;
	};

	mcucfg@10203000 {
		compatible = "mediatek,mcucfg";
		interrupts = <0x0 0x9 0x8>;
		reg = <0x0 0x10203000 0x0 0x1000>;
	};

	mcucfg_mp0_counter@10200000 {
		compatible = "mediatek,mcucfg_mp0_counter";
		reg = <0x0 0x10200000 0x0 0x4000>;
	};

	mcupm_reg@10216000 {
		compatible = "mediatek,mcupm_reg";
		reg = <0x0 0x10216000 0x0 0x1000>;
	};

	mcupm_sram0@10217000 {
		compatible = "mediatek,mcupm_sram0";
		reg = <0x0 0x10217000 0x0 0x1000>;
	};

	mcupm_sram1@10218000 {
		compatible = "mediatek,mcupm_sram1";
		reg = <0x0 0x10218000 0x0 0x1000>;
	};

	mcupm_sram2@10211000 {
		compatible = "mediatek,mcupm_sram2";
		reg = <0x0 0x10211000 0x0 0x1000>;
	};

	mcupm_sram3@10213000 {
		compatible = "mediatek,mcupm_sram3";
		reg = <0x0 0x10213000 0x0 0x1000>;
	};

	md1_sim1_hot_plug_eint {
		phandle = <0x8b>;
	};

	md1_sim2_hot_plug_eint {
		phandle = <0x8c>;
	};

	md_auxadc {
		compatible = "mediatek,md_auxadc";
		io-channel-names = "md-channel", "md-battery";
		io-channels = <0x36 0x2>;
		phandle = <0xbd>;
	};

	md_ccif0@1020a000 {
		compatible = "mediatek,md_ccif0";
		reg = <0x0 0x1020a000 0x0 0x1000>;
	};

	md_ccif1@1020c000 {
		compatible = "mediatek,md_ccif1";
		reg = <0x0 0x1020c000 0x0 0x1000>;
	};

	md_ccif2@1023d000 {
		compatible = "mediatek,md_ccif2";
		reg = <0x0 0x1023d000 0x0 0x1000>;
	};

	md_ccif3@1023f000 {
		compatible = "mediatek,md_ccif3";
		reg = <0x0 0x1023f000 0x0 0x1000>;
	};

	mdcldmain@1021c000 {
		compatible = "mediatek,mdcldmain";
		reg = <0x0 0x1021c000 0x0 0x400>;
	};

	mdcldmain_ao@10015000 {
		compatible = "mediatek,mdcldmain_ao";
		reg = <0x0 0x10015000 0x0 0x400>;
	};

	mdcldmamisc@1021c800 {
		compatible = "mediatek,mdcldmamisc";
		reg = <0x0 0x1021c800 0x0 0x1000>;
	};

	mdcldmamisc_ao@10015800 {
		compatible = "mediatek,mdcldmamisc_ao";
		reg = <0x0 0x10015800 0x0 0x400>;
	};

	mdcldmaout@1021c400 {
		compatible = "mediatek,mdcldmaout";
		reg = <0x0 0x1021c400 0x0 0x400>;
	};

	mdcldmaout_ao@10015400 {
		compatible = "mediatek,mdcldmaout_ao";
		reg = <0x0 0x10015400 0x0 0x400>;
	};

	mddriver@10014000 {
		_vcore-supply = <0x35>;
		_vmodem-supply = <0x34>;
		ccci-infracfg = <0x22>;
		clock-names = "scp-sys-md1-main", "infra-cldma-bclk", "infra-ccif-ap", "infra-ccif-md", "infra-ccif1-ap", "infra-ccif1-md", "infra-ccif2-ap", "infra-ccif2-md";
		clocks = <0x33 0x0 0x22 0x32 0x22 0x29 0x22 0x2c 0x22 0x23 0x22 0x24 0x22 0x58 0x22 0x59>;
		compatible = "mediatek,mddriver", "mediatek,mddriver-mt6761";
		interrupts = <0x0 0x6d 0x4 0x0 0x5c 0x8 0x0 0x5d 0x8 0x0 0xcd 0x2>;
		mediatek,ap_plat_info = <0x1a69>;
		mediatek,cldma_capability = <0x6>;
		mediatek,md_generation = <0x1895>;
		mediatek,md_id = <0x0>;
		mediatek,mdhif_type = <0x3>;
		mediatek,offset_apon_md1 = <0x1c24>;
		phandle = <0x15>;
		reg = <0x0 0x10014000 0x0 0x1000 0x0 0x1021b000 0x0 0x1000 0x0 0x10209000 0x0 0x1000 0x0 0x1020a000 0x0 0x1000>;
	};

	mdp_ccorr0@14005000 {
		clock-names = "MDP_CCORR";
		clocks = <0x10 0x1>;
		compatible = "mediatek,mdp_ccorr0";
		interrupts = <0x0 0xaa 0x8>;
		phandle = <0x40>;
		reg = <0x0 0x14005000 0x0 0x1000>;
	};

	mdp_rdma0@14004000 {
		clock-names = "MDP_RDMA0";
		clocks = <0x10 0x0>;
		compatible = "mediatek,mdp_rdma0";
		interrupts = <0x0 0x9b 0x8>;
		phandle = <0x39>;
		reg = <0x0 0x14004000 0x0 0x1000>;
	};

	mdp_rsz0@14006000 {
		clock-names = "MDP_RSZ0";
		clocks = <0x10 0x2>;
		compatible = "mediatek,mdp_rsz0";
		interrupts = <0x0 0x9c 0x8>;
		phandle = <0x3a>;
		reg = <0x0 0x14006000 0x0 0x1000>;
	};

	mdp_rsz1@14007000 {
		clock-names = "MDP_RSZ1";
		clocks = <0x10 0x3>;
		compatible = "mediatek,mdp_rsz1";
		interrupts = <0x0 0x9d 0x8>;
		phandle = <0x3b>;
		reg = <0x0 0x14007000 0x0 0x1000>;
	};

	mdp_tdshp0@1400a000 {
		clock-names = "MDP_TDSHP";
		clocks = <0x10 0x4>;
		compatible = "mediatek,mdp_tdshp0";
		phandle = <0x3e>;
		reg = <0x0 0x1400a000 0x0 0x1000>;
	};

	mdp_wdma0@14008000 {
		clock-names = "MDP_WDMA";
		clocks = <0x10 0x6>;
		compatible = "mediatek,mdp_wdma0";
		interrupts = <0x0 0xa0 0x8>;
		phandle = <0x3c>;
		reg = <0x0 0x14008000 0x0 0x1000>;
	};

	mdp_wrot0@14009000 {
		clock-names = "MDP_WROT0";
		clocks = <0x10 0x5>;
		compatible = "mediatek,mdp_wrot0";
		interrupts = <0x0 0x9f 0x8>;
		phandle = <0x3d>;
		reg = <0x0 0x14009000 0x0 0x1000>;
	};

	memory {
		device_type = "memory";
		reg = <0x0 0x40000000 0x0 0x20000000>;
	};

	memory-ssmr-features {
		compatible = "mediatek,memory-ssmr-features";
		phandle = <0xf2>;
		svp-size = <0x0 0x10000000>;
	};

	mfg_cfg@13ffe000 {
		#clock-cells = <0x1>;
		compatible = "mediatek,mfgcfg", "syscon";
		phandle = <0xe4>;
		reg = <0x0 0x13ffe000 0x0 0x1000>;
	};

	mfg_clark@13000000 {
		clock-frequency = <0x21f98280>;
		compatible = "mediatek,clark";
		ged-supply = <0x59>;
		interrupt-names = "RGX";
		interrupts = <0x0 0xcb 0x8>;
		phandle = <0xe3>;
		reg = <0x0 0x13000000 0x0 0x80000>;
	};

	mipi_rx_ana_csi0a@11c10000 {
		#clock-cells = <0x1>;
		compatible = "mediatek,mt6761-mipi0a", "syscon";
		phandle = <0x5b>;
		reg = <0x0 0x11c10000 0x0 0x1000>;
	};

	mipi_rx_ana_csi0b@11c11000 {
		#clock-cells = <0x1>;
		compatible = "mediatek,mt6761-mipi0b", "syscon";
		phandle = <0xde>;
		reg = <0x0 0x11c11000 0x0 0x1000>;
	};

	mipi_rx_ana_csi1@11c20000 {
		compatible = "mediatek,mipi_rx_ana_csi1";
		reg = <0x0 0x11c20000 0x0 0x10000>;
	};

	mipi_rx_ana_csi1a@11c12000 {
		#clock-cells = <0x1>;
		compatible = "mediatek,mt6761-mipi1a", "syscon";
		phandle = <0xdf>;
		reg = <0x0 0x11c12000 0x0 0x1000>;
	};

	mipi_rx_ana_csi1b@11c13000 {
		#clock-cells = <0x1>;
		compatible = "mediatek,mt6761-mipi1b", "syscon";
		phandle = <0xe0>;
		reg = <0x0 0x11c13000 0x0 0x1000>;
	};

	mipi_rx_ana_csi2@11c30000 {
		compatible = "mediatek,mipi_rx_ana_csi2";
		reg = <0x0 0x11c30000 0x0 0x10000>;
	};

	mipi_rx_ana_csi2a@11c14000 {
		#clock-cells = <0x1>;
		compatible = "mediatek,mt6761-mipi2a", "syscon";
		phandle = <0xe1>;
		reg = <0x0 0x11c14000 0x0 0x1000>;
	};

	mipi_rx_ana_csi2b@11c15000 {
		#clock-cells = <0x1>;
		compatible = "mediatek,mt6761-mipi2b", "syscon";
		phandle = <0xe2>;
		reg = <0x0 0x11c15000 0x0 0x1000>;
	};

	mipi_tx0@11c80000 {
		compatible = "mediatek,mipi_tx0";
		reg = <0x0 0x11c80000 0x0 0x10000>;
	};

	mm_mutex@14016000 {
		compatible = "mediatek,mm_mutex";
		phandle = <0xea>;
		reg = <0x0 0x14016000 0x0 0x1000>;
	};

	mmdvfs_pmqos {
		cam_freq = "mm_step0", "mm_step1", "mm_step2";
		clock-names = "mmdvfs_clk_mm_sel_ck", "mmdvfs_clk_mmpll_ck", "mmdvfs_clk_univpll1_d2_ck", "mmdvfs_clk_mmpll_d2_ck";
		clocks = <0xf 0x6b 0xf 0x24 0xf 0x1a 0xf 0x25>;
		compatible = "mediatek,mmdvfs_pmqos";
		disp_freq = "mm_step0", "mm_step1", "mm_step2";
		img_freq = "mm_step0", "mm_step1", "mm_step2";
		mdp_freq = "mm_step0", "mm_step1", "mm_step2";
		mm_step0 = <0x1b4 0x1 0x0 0x1>;
		mm_step0_ext = <0x1b4 0x2 0x6 0x10c4ec>;
		mm_step1 = <0x138 0x1 0x0 0x2>;
		mm_step1_ext = <0x138 0x2 0x6 0x10c4ec>;
		mm_step2 = <0xe3 0x1 0x0 0x3>;
		mm_step2_ext = <0xe3 0x2 0x6 0x117627>;
		vdec_freq = "mm_step0", "mm_step1", "mm_step2";
		venc_freq = "mm_step0", "mm_step1", "mm_step2";
		vopp_steps = <0x0 0x1 0x3>;
	};

	mmsys_config@14000000 {
		#clock-cells = <0x1>;
		compatible = "mediatek,mt6761-mmsys_config", "syscon";
		interrupts = <0x0 0xab 0x8>;
		phandle = <0x10>;
		reg = <0x0 0x14000000 0x0 0x1000>;
	};

	mobicore {
		compatible = "trustonic,mobicore";
		interrupts = <0x0 0xc2 0x1>;
	};

	modem_temp_share@10018000 {
		compatible = "mediatek,modem_temp_share";
		reg = <0x0 0x10018000 0x0 0x1000>;
	};

	mrdump_ext_rst {
		compatible = "mediatek, mrdump_ext_rst-eint";
		force_mode = "EINT";
		mode = "IRQ";
		phandle = <0xb4>;
		status = "okay";
	};

	msdc0_pad_macro@11cd0000 {
		compatible = "mediatek,msdc0_pad_macro";
		reg = <0x0 0x11cd0000 0x0 0x10000>;
	};

	msdc0_top@11cd0000 {
		compatible = "mediatek,msdc0_top";
		reg = <0x0 0x11cd0000 0x0 0x1000>;
	};

	msdc1_ins@0 {
		compatible = "mediatek,mt6761-sdcard-ins";
		phandle = <0xdb>;
	};

	msdc1_pad_macro@11c90000 {
		compatible = "mediatek,msdc1_pad_macro";
		reg = <0x0 0x11c90000 0x0 0x10000>;
	};

	msdc1_top@11c90000 {
		compatible = "mediatek,msdc1_top";
		reg = <0x0 0x11c90000 0x0 0x1000>;
	};

	msdc@11230000 {
		bootable;
		bus-width = <0x8>;
		cap-mmc-highspeed;
		clk_src = [01];
		clock-names = "msdc0-clock", "msdc0-hclock", "msdc0-aes-clock";
		clocks = <0x22 0x4f 0x22 0x1c 0x22 0x45>;
		compatible = "mediatek,msdc";
		host_function = [00];
		index = [00];
		interrupts = <0x0 0x17 0x8>;
		max-frequency = <0xbebc200>;
		mmc-ddr-1_8v;
		mmc-hs200-1_8v;
		mmc-hs400-1_8v;
		no-sd;
		no-sdio;
		non-removable;
		phandle = <0xd7>;
		pinctl = <0x4b>;
		pinctl_hs200 = <0x4d>;
		pinctl_hs400 = <0x4c>;
		reg = <0x0 0x11230000 0x0 0x10000>;
		register_setting = <0x4e>;
		status = "okay";
		vmmc-supply = <0x4f>;
	};

	msdc@11240000 {
		bus-width = <0x4>;
		cap-sd-highspeed;
		cd-gpios = <0x1e 0x50 0x0>;
		cd_level = [00];
		clk_src = [02];
		clock-names = "msdc1-clock", "msdc1-hclock";
		clocks = <0x22 0x50 0x22 0x1d>;
		compatible = "mediatek,msdc";
		host_function = [01];
		index = [01];
		interrupts = <0x0 0x18 0x8>;
		max-frequency = <0xbebc200>;
		mediatek,pwrap-regmap = <0x12>;
		no-mmc;
		no-sdio;
		phandle = <0xd8>;
		pinctl = <0x50>;
		pinctl_ddr50 = <0x53>;
		pinctl_sdr104 = <0x51>;
		pinctl_sdr50 = <0x52>;
		reg = <0x0 0x11240000 0x0 0x10000>;
		register_setting = <0x54>;
		sd-uhs-ddr50;
		sd-uhs-sdr12;
		sd-uhs-sdr25;
		sd-uhs-sdr50;
		status = "okay";
		vmmc-supply = <0x55>;
		vqmmc-supply = <0x56>;
	};

	msdc@11250000 {
		compatible = "mediatek,msdc2";
		phandle = <0xd9>;
		reg = <0x0 0x11250000 0x0 0x10000>;
		status = "disable";
	};

	msdc@11260000 {
		compatible = "mediatek,msdc3";
		phandle = <0xda>;
		reg = <0x0 0x11250000 0x0 0x10000>;
		status = "disable";
	};

	mt6370_pmu_dts {
		#interrupt-cells = <0x1>;
		interrupt-controller;
		mt6370,intr_gpio = <0x1e 0x3 0x0>;
		mt6370,intr_gpio_num = <0x3>;
		phandle = <0x102>;

		bled {
			compatible = "mediatek,mt6370_pmu_bled";
			interrupt-names = "bled_ocp";
			mt,bl_ocp_level = <0x2>;
			mt,bl_ovp_level = <0x3>;
			mt,bled_curr_scale = <0x0>;
			mt,bled_flash_ramp = <0x1>;
			mt,bled_name = "mt6370_pmu_bled";
			mt,bled_ramptime = <0x3>;
			mt,chan_en = <0xf>;
			mt,map_linear;
			mt,max_bled_brightness = <0x200>;
			mt,pwm_avg_cycle = <0x0>;
			mt,pwm_deglitch = <0x1>;
			mt,pwm_fsample = <0x2>;
			mt,pwm_hys = <0x0>;
			mt,pwm_hys_en = <0x1>;
			mt,pwm_lpf_coef = <0x0>;
			mt,use_pwm;
		};

		charger {
			aicr = <0x7a120>;
			bc12_sel = <0x0>;
			charger = <0x7e>;
			charger_name = "primary_chg";
			compatible = "mediatek,mt6370_pmu_charger";
			cv = <0x426030>;
			dc_wdt = <0x3d0900>;
			enable_te;
			enable_wdt;
			ichg = <0x1e8480>;
			ieoc = <0x249f0>;
			interrupt-names = "chg_mivr", "chg_aiclmeasi", "attachi", "ovpctrl_uvp_d_evt", "chg_wdtmri", "chg_vbusov", "chg_tmri", "chg_treg", "dcdti";
			ircmp_resistor = <0x61a8>;
			ircmp_vclamp = <0x7d00>;
			lbp_dt = <0x1>;
			lbp_hys_sel = <0x1>;
			load_switch_name = "primary_load_switch";
			mivr = <0x432380>;
			phandle = <0x7e>;
			safety_timer = <0xc>;

			usb-otg-vbus {
				phandle = <0x103>;
				regulator-compatible = "usb-otg-vbus";
				regulator-max-microamp = <0x2dc6c0>;
				regulator-max-microvolt = <0x588040>;
				regulator-min-microamp = <0x7a120>;
				regulator-min-microvolt = <0x426030>;
				regulator-name = "usb-otg-vbus";
			};
		};

		core {
			compatible = "mediatek,mt6370_pmu_core";
			i2cstmr_rst_tmr = <0x0>;
			int_deg = <0x0>;
			int_wdt = <0x0>;
			interrupt-names = "otp", "vdda_ovp", "vdda_uv";
			mrstb_en;
			mrstb_tmr = <0x3>;
		};

		dsv {
			compatible = "mediatek,mt6370_pmu_dsv";
			db_delay = <0x3>;
			db_ext_en = <0x0>;
			db_freq_pm = <0x0>;
			db_periodic_fix = <0x0>;
			db_periodic_mode = <0x0>;
			db_single_pin = <0x0>;
			db_startup = <0x0>;
			db_vbst = <0x1644>;
			db_vneg_20ms = <0x1>;
			db_vneg_disc = <0x0>;
			db_vneg_slew = <0x1>;
			db_vpos_20ms = <0x1>;
			db_vpos_disc = <0x1>;
			db_vpos_slew = <0x1>;
			interrupt-names = "dsv_vneg_ocp", "dsv_vpos_ocp", "dsv_bst_ocp", "dsv_vneg_scp", "dsv_vpos_scp";

			mt6370_dsvn {
				regulator-max-microvolt = <0x5b8d80>;
				regulator-min-microvolt = <0x3d0900>;
				regulator-name = "dsv_neg";
			};

			mt6370_dsvp {
				regulator-max-microvolt = <0x5b8d80>;
				regulator-min-microvolt = <0x3d0900>;
				regulator-name = "dsv_pos";
			};
		};

		ldo {
			compatible = "mediatek,mt6370_pmu_ldo";
			interrupt-names = "ldo_oc";
			ldo_oms = <0x1>;
			ldo_vrc_lt = <0x1>;

			mt6370_ldo {
				regulator-max-microvolt = <0x3d0900>;
				regulator-min-microvolt = <0x186a00>;
				regulator-name = "irtx_ldo";
			};
		};

		mt6370_pmu_fled1 {
			compatible = "mediatek,mt6370_pmu_fled1";
			fled_enable = <0x1>;
			interrupt-names = "fled_lvf", "fled2_short", "fled1_short";
			strobe_cur = <0x124f80>;
			strobe_timeout = <0x960>;
			torch_cur = <0x493e0>;
		};

		mt6370_pmu_fled2 {
			compatible = "mediatek,mt6370_pmu_fled2";
			fled_enable = <0x1>;
			strobe_cur = <0xf4240>;
			strobe_timeout = <0x4b0>;
			torch_cur = <0x30d40>;
		};

		rgbled {
			compatible = "mediatek,mt6370_pmu_rgbled";
			interrupt-names = "isink4_short", "isink3_short", "isink2_short", "isink1_short", "isink4_open", "isink3_open", "isink2_open", "isink1_open";
			mt,led_default_trigger = "cc_mode", "cc_mode", "cc_mode", "none";
			mt,led_name = "mt6370_pmu_led1", "mt6370_pmu_led2", "mt6370_pmu_led3", "mt6370_pmu_led4";
		};
	};

	mt6370_pmu_eint {
		phandle = <0xfa>;
	};

	mt_soc_anc_pcm {
		compatible = "mediatek,mt_soc_pcm_anc";
	};

	mt_soc_codec_dummy_name {
		compatible = "mediatek,mt_soc_codec_dummy";
	};

	mt_soc_dai_name {
		compatible = "mediatek,mt_soc_dai_stub";
	};

	mt_soc_deep_buffer_dl_pcm {
		compatible = "mediatek,mt_soc_pcm_deep_buffer_dl";
	};

	mt_soc_dl1_awb_pcm {
		compatible = "mediatek,mt_soc_pcm_dl1_awb";
	};

	mt_soc_dl1_pcm@11220000 {
		clock-names = "aud_afe_clk", "aud_dac_clk", "aud_dac_predis_clk", "aud_adc_clk", "aud_apll22m_clk", "aud_apll1_tuner_clk", "aud_tml_clk", "aud_infra_clk", "mtkaif_26m_clk", "top_mux_audio", "top_mux_audio_int", "top_sys_pll1_d4", "top_mux_aud_1", "top_apll1_ck", "top_mux_aud_eng1", "top_apll1_d8", "apmixed_apll1", "top_clk26m_clk";
		clocks = <0x58 0x0 0x58 0x4 0x58 0x5 0x58 0x3 0x58 0x1 0x58 0x2 0x58 0x6 0x22 0x2b 0x22 0x33 0xf 0x78 0xf 0x79 0xf 0x5 0xf 0x7a 0xf 0x2b 0xf 0x7b 0xf 0x2e 0x20 0x6 0x21>;
		compatible = "mediatek,mt_soc_pcm_dl1";
		interrupts = <0x0 0x61 0x8>;
		phandle = <0xdd>;
		reg = <0x0 0x11220000 0x0 0x1000>;
	};

	mt_soc_dl2_pcm {
		compatible = "mediatek,mt_soc_pcm_dl2";
	};

	mt_soc_dummy_pcm {
		compatible = "mediatek,mt_soc_pcm_dummy";
	};

	mt_soc_fm_i2s_awb_pcm {
		compatible = "mediatek,mt_soc_pcm_fm_i2s_awb";
	};

	mt_soc_fm_i2s_pcm {
		compatible = "mediatek,mt_soc_pcm_fm_i2s";
	};

	mt_soc_fm_mrgtx_pcm {
		compatible = "mediatek,mt_soc_pcm_fmtx";
	};

	mt_soc_hp_impedance_pcm {
		compatible = "mediatek,mt_soc_pcm_hp_impedance";
	};

	mt_soc_i2s0_awb_pcm {
		compatible = "mediatek,mt_soc_pcm_i2s0_awb";
	};

	mt_soc_i2s0_pcm {
		compatible = "mediatek,mt_soc_pcm_dl1_i2s0";
	};

	mt_soc_i2s0dl1_pcm {
		compatible = "mediatek,mt_soc_pcm_dl1_i2s0dl1";
	};

	mt_soc_mrgrx_awb_pcm {
		compatible = "mediatek,mt_soc_pcm_mrgrx_awb";
	};

	mt_soc_mrgrx_pcm {
		compatible = "mediatek,mt_soc_pcm_mrgrx";
	};

	mt_soc_pcm_dl1_scp_spk {
		compatible = "mediatek,mt_soc_pcm_dl1_scp_spk";
	};

	mt_soc_pcm_voice_scp {
		compatible = "mediatek,mt_soc_pcm_voice_scp";
	};

	mt_soc_pcm_voice_ultra {
		compatible = "mediatek,mt_soc_pcm_voice_ultra";
	};

	mt_soc_pcm_voice_usb {
		compatible = "mediatek,mt_soc_pcm_voice_usb";
	};

	mt_soc_pcm_voice_usb_echoref {
		compatible = "mediatek,mt_soc_pcm_voice_usb_echoref";
	};

	mt_soc_routing_dai_name {
		compatible = "mediatek,mt_soc_dai_routing";
	};

	mt_soc_routing_pcm {
		compatible = "mediatek,mt_soc_pcm_routing";
	};

	mt_soc_tdmrx_pcm {
		compatible = "mediatek,mt_soc_tdm_capture";
	};

	mt_soc_ul1_pcm {
		compatible = "mediatek,mt_soc_pcm_capture";
	};

	mt_soc_ul2_pcm {
		compatible = "mediatek,mt_soc_pcm_capture2";
	};

	mt_soc_uldlloopback_pcm {
		compatible = "mediatek,mt_soc_pcm_uldlloopback";
	};

	mt_soc_voice_md1 {
		compatible = "mediatek,mt_soc_pcm_voice_md1";
	};

	mt_soc_voice_md1_bt {
		compatible = "mediatek,mt_soc_pcm_voice_md1_bt";
	};

	mt_soc_voice_md2 {
		compatible = "mediatek,mt_soc_pcm_voice_md2";
	};

	mt_soc_voice_md2_bt {
		compatible = "mediatek,mt_soc_pcm_voice_md2_bt";
	};

	mt_soc_voip_bt_in {
		compatible = "mediatek,mt_soc_pcm_bt_dai";
	};

	mt_soc_voip_bt_out {
		compatible = "mediatek,mt_soc_pcm_dl1_bt";
	};

	mtk-btcvsd-snd@18050000 {
		compatible = "mediatek,mtk-btcvsd-snd";
		disable_write_silence = <0x0>;
		interrupts = <0x0 0xd2 0x8>;
		mediatek,infracfg = <0x22>;
		mediatek,offset = <0xf00 0x800 0x140 0x144 0x148>;
		phandle = <0x57>;
		reg = <0x0 0x18050000 0x0 0x1000 0x0 0x18080000 0x0 0x10000>;
	};

	mtkfb@0 {
		compatible = "mediatek,mtkfb";
		phandle = <0xe8>;
	};

	nfc {
		compatible = "mediatek,nfc-gpio-v2";
		gpio-irq = <0xa>;
		gpio-irq-std = <0x1e 0xa 0x0>;
		gpio-rst = <0xac>;
		gpio-rst-std = <0x1e 0xac 0x0>;
		phandle = <0xe5>;
	};

	nfi@11018000 {
		compatible = "mediatek,nfi";
		reg = <0x0 0x11018000 0x0 0x1000>;
	};

	nfiecc@11019000 {
		compatible = "mediatek,nfiecc";
		reg = <0x0 0x11019000 0x0 0x1000>;
	};

	odm {
		compatible = "simple-bus";
		phandle = <0xf1>;
	};

	opp_table0 {
		compatible = "operating-points-v2";
		opp-shared;
		phandle = <0x2>;

		opp0 {
			opp-hz = <0x0 0x32a9f880>;
			opp-microvolt = <0x9eb10>;
		};

		opp1 {
			opp-hz = <0x0 0x36b79180>;
			opp-microvolt = <0xa344e>;
		};

		opp10 {
			opp-hz = <0x0 0x61559a40>;
			opp-microvolt = <0xd8acc>;
		};

		opp11 {
			opp-hz = <0x0 0x6553f100>;
			opp-microvolt = <0xdec74>;
		};

		opp12 {
			opp-hz = <0x0 0x695247c0>;
			opp-microvolt = <0xe4e1c>;
		};

		opp13 {
			opp-hz = <0x0 0x6d509e80>;
			opp-microvolt = <0xeafc4>;
		};

		opp14 {
			opp-hz = <0x0 0x72431940>;
			opp-microvolt = <0xf29d6>;
		};

		opp15 {
			opp-hz = <0x0 0x7744d640>;
			opp-microvolt = <0xfa3e8>;
		};

		opp2 {
			opp-hz = <0x0 0x3ad46cc0>;
			opp-microvolt = <0xa7d8c>;
		};

		opp3 {
			opp-hz = <0x0 0x3ef14800>;
			opp-microvolt = <0xac6ca>;
		};

		opp4 {
			opp-hz = <0x0 0x430e2340>;
			opp-microvolt = <0xb1008>;
		};

		opp5 {
			opp-hz = <0x0 0x487ab000>;
			opp-microvolt = <0xb71b0>;
		};

		opp6 {
			opp-hz = <0x0 0x4df67f00>;
			opp-microvolt = <0xbd358>;
		};

		opp7 {
			opp-hz = <0x0 0x53724e00>;
			opp-microvolt = <0xc3500>;
		};

		opp8 {
			opp-hz = <0x0 0x57616280>;
			opp-microvolt = <0xc96a8>;
		};

		opp9 {
			opp-hz = <0x0 0x5b5fb940>;
			opp-microvolt = <0xcf850>;
		};
	};

	otg_iddig {
		compatible = "mediatek,usb_iddig_bi_eint";
		phandle = <0xf0>;
	};

	pbm {
		compatible = "mediatek,pbm";
		io-channel-names = "pmic_batadc";
		io-channels = <0x23 0x0>;
		phandle = <0xfc>;
	};

	pd_adapter {
		adapter_name = "pd_adapter";
		compatible = "mediatek,pd_adapter";
		phandle = <0xf8>;
	};

	pdc {
		compatible = "mediatek,charger,pd";
		dcs_chg1_charger_current = <0x16e360>;
		dcs_chg2_charger_current = <0x16e360>;
		dcs_input_current = <0x30d400>;
		dual_polling_ieoc = <0x6ddd0>;
		gauge = <0x7a>;
		ibus_err = <0xe>;
		min_charger_voltage = <0x4630c0>;
		pd_stop_battery_soc = <0x50>;
		pd_vbus_low_bound = <0x4c4b40>;
		pd_vbus_upper_bound = <0x4c4b40>;
		phandle = <0xf6>;
		sc_charger_current = <0x2dc6c0>;
		sc_input_current = <0x30d400>;
		slave_mivr_diff = <0x186a0>;
		vsys_watt = <0x4c4b40>;
	};

	pe {
		compatible = "mediatek,charger,pe";
		gauge = <0x7a>;
		min_charger_voltage = <0x4630c0>;
		pe_charger_current = <0x2dc6c0>;
		pe_ichg_level_threshold = <0xf4240>;
		phandle = <0xf4>;
		ta_12v_support;
		ta_9v_support;
		ta_ac_12v_input_current = <0x30d400>;
		ta_ac_7v_input_current = <0x30d400>;
		ta_ac_9v_input_current = <0x30d400>;
		ta_start_battery_soc = <0x0>;
		ta_stop_battery_soc = <0x55>;
	};

	pe2 {
		cable_imp_threshold = <0x2bb>;
		compatible = "mediatek,charger,pe2";
		dcs_chg1_charger_current = <0x16e360>;
		dcs_chg2_charger_current = <0x16e360>;
		dcs_input_current = <0x30d400>;
		dual_polling_ieoc = <0x6ddd0>;
		gauge = <0x7a>;
		min_charger_voltage = <0x4630c0>;
		pe20_ichg_level_threshold = <0xf4240>;
		phandle = <0xf5>;
		sc_charger_current = <0x2dc6c0>;
		sc_input_current = <0x30d400>;
		slave_mivr_diff = <0x186a0>;
		ta_start_battery_soc = <0x0>;
		ta_stop_battery_soc = <0x55>;
		vbat_cable_imp_threshold = <0x3b8260>;
	};

	pe4 {
		compatible = "mediatek,charger,pe4";
		dcs_chg1_charger_current = <0x16e360>;
		dcs_chg2_charger_current = <0x16e360>;
		dcs_input_current = <0x30d400>;
		dual_polling_ieoc = <0x6ddd0>;
		gauge = <0x7a>;
		high_temp_to_enter_pe40 = <0x27>;
		high_temp_to_leave_pe40 = <0x2e>;
		ibus_err = <0xe>;
		low_temp_to_enter_pe40 = <0x10>;
		low_temp_to_leave_pe40 = <0xa>;
		min_charger_voltage = <0x4630c0>;
		pe40_r_cable_1a_lower = <0x1f4>;
		pe40_r_cable_2a_lower = <0x15f>;
		pe40_r_cable_3a_lower = <0xf0>;
		pe40_stop_battery_soc = <0x50>;
		phandle = <0xf7>;
		sc_charger_current = <0x2dc6c0>;
		sc_input_current = <0x30d400>;
		slave_mivr_diff = <0x186a0>;
	};

	pericfg@10003000 {
		#clock-cells = <0x1>;
		compatible = "mediatek,pericfg", "syscon";
		phandle = <0x88>;
		reg = <0x0 0x10003000 0x0 0x1000>;
	};

	pinctrl@10005000 {
		#gpio-cells = <0x2>;
		#interrupt-cells = <0x2>;
		compatible = "mediatek,mt6761-pinctrl";
		gpio-controller;
		gpio-ranges = <0x1e 0x0 0x0 0xb3>;
		interrupt-controller;
		interrupt-parent = <0xe>;
		interrupts = <0x0 0x73 0x4>;
		phandle = <0x1e>;
		pins-are-numbered;
		reg_bases = <0x16 0x17 0x18 0x19 0x1a 0x1b 0x1c 0x1d>;

		cam0@0 {
			phandle = <0x5d>;

			pins_cmd_dat {
				output-low;
				pinmux = <0x6500>;
				slew-rate = <0x1>;
			};
		};

		cam0@1 {
			phandle = <0x5e>;

			pins_cmd_dat {
				output-high;
				pinmux = <0x6500>;
				slew-rate = <0x1>;
			};
		};

		cam0@2 {
			phandle = <0x5f>;

			pins_cmd_dat {
				output-low;
				pinmux = <0x6100>;
				slew-rate = <0x1>;
			};
		};

		cam0@3 {
			phandle = <0x60>;

			pins_cmd_dat {
				output-high;
				pinmux = <0x6100>;
				slew-rate = <0x1>;
			};
		};

		cam0@vcama0 {
			phandle = <0x66>;

			pins_cmd_dat {
				output-low;
				pinmux = <0xa900>;
				slew-rate = <0x1>;
			};
		};

		cam0@vcama1 {
			phandle = <0x65>;

			pins_cmd_dat {
				output-high;
				pinmux = <0xa900>;
				slew-rate = <0x1>;
			};
		};

		cam1@0 {
			phandle = <0x61>;

			pins_cmd_dat {
				output-low;
				pinmux = <0x6600>;
				slew-rate = <0x1>;
			};
		};

		cam1@1 {
			phandle = <0x62>;

			pins_cmd_dat {
				output-high;
				pinmux = <0x6600>;
				slew-rate = <0x1>;
			};
		};

		cam1@2 {
			phandle = <0x63>;

			pins_cmd_dat {
				output-low;
				pinmux = <0x6200>;
				slew-rate = <0x1>;
			};
		};

		cam1@3 {
			phandle = <0x64>;

			pins_cmd_dat {
				output-high;
				pinmux = <0x6200>;
				slew-rate = <0x1>;
			};
		};

		cam1@vcamd0 {
			phandle = <0x68>;

			pins_cmd_dat {
				output-low;
				pinmux = <0xa800>;
				slew-rate = <0x1>;
			};
		};

		cam1@vcamd1 {
			phandle = <0x67>;

			pins_cmd_dat {
				output-high;
				pinmux = <0xa800>;
				slew-rate = <0x1>;
			};
		};

		camdefault {
			phandle = <0x5c>;
		};

		camera_pins_cam0_mclk_off {
			phandle = <0x6a>;

			pins_cmd_dat {
				pinmux = <0x6300>;
			};
		};

		camera_pins_cam0_mclk_on {
			phandle = <0x69>;

			pins_cmd_dat {
				pinmux = <0x6301>;
			};
		};

		camera_pins_cam1_mclk_off {
			phandle = <0x6c>;

			pins_cmd_dat {
				pinmux = <0x6400>;
			};
		};

		camera_pins_cam1_mclk_on {
			phandle = <0x6b>;

			pins_cmd_dat {
				pinmux = <0x6401>;
			};
		};

		enf_gpio@0 {
			phandle = <0x77>;

			pins_cmd_dat {
				output-low;
				pinmux = <0xa700>;
				slew-rate = <0x1>;
			};
		};

		enf_gpio@1 {
			phandle = <0x78>;

			pins_cmd_dat {
				output-high;
				pinmux = <0xa700>;
				slew-rate = <0x1>;
			};
		};

		enm_gpio@0 {
			phandle = <0x73>;

			pins_cmd_dat {
				output-low;
				pinmux = <0x9600>;
				slew-rate = <0x1>;
			};
		};

		enm_gpio@1 {
			phandle = <0x74>;

			pins_cmd_dat {
				output-high;
				pinmux = <0x9600>;
				slew-rate = <0x1>;
			};
		};

		enm_pwm@0 {
			phandle = <0x75>;

			pins_cmd_dat {
				bias-disable;
				pinmux = <0x9601>;
				slew-rate = <0x1>;
			};
		};

		enm_pwm@1 {
			phandle = <0x76>;

			pins_cmd_dat {
				bias-disable;
				pinmux = <0x9601>;
				slew-rate = <0x1>;
			};
		};

		flashlight_default {
			phandle = <0x72>;
		};

		lcd_bias_gpio_enn0 {
			phandle = <0x82>;

			pins_cmd_dat {
				output-low;
				pinmux = <0xe00>;
				slew-rate = <0x1>;
			};
		};

		lcd_bias_gpio_enn1 {
			phandle = <0x83>;

			pins_cmd_dat {
				output-high;
				pinmux = <0xe00>;
				slew-rate = <0x1>;
			};
		};

		lcd_bias_gpio_enp0 {
			phandle = <0x80>;

			pins_cmd_dat {
				output-low;
				pinmux = <0x1000>;
				slew-rate = <0x1>;
			};
		};

		lcd_bias_gpio_enp1 {
			phandle = <0x81>;

			pins_cmd_dat {
				output-high;
				pinmux = <0x1000>;
				slew-rate = <0x1>;
			};
		};

		lcd_bias_pins_default {
			phandle = <0x7f>;
		};

		msdc0@default {
			phandle = <0x4b>;

			pins_clk {
				drive-strength = [03];
			};

			pins_cmd {
				drive-strength = [03];
			};

			pins_dat {
				drive-strength = [03];
			};

			pins_ds {
				drive-strength = [03];
			};

			pins_rst {
				drive-strength = [03];
			};
		};

		msdc0@hs200 {
			phandle = <0x4d>;

			pins_clk {
				drive-strength = [04];
			};

			pins_cmd {
				drive-strength = [03];
			};

			pins_dat {
				drive-strength = [04];
			};

			pins_ds {
				drive-strength = [04];
			};

			pins_rst {
				drive-strength = [03];
			};
		};

		msdc0@hs400 {
			phandle = <0x4c>;

			pins_clk {
				drive-strength = [04];
			};

			pins_cmd {
				drive-strength = [03];
			};

			pins_dat {
				drive-strength = [04];
			};

			pins_ds {
				drive-strength = [04];
			};

			pins_rst {
				drive-strength = [03];
			};
		};

		msdc0@register_default {
			cmd_edge = [00];
			phandle = <0x4e>;
			rdata_edge = [00];
			wdata_edge = [00];
		};

		msdc1@ddr50 {
			phandle = <0x53>;

			pins_clk {
				drive-strength = [03];
			};

			pins_cmd {
				drive-strength = [03];
			};

			pins_dat {
				drive-strength = [03];
			};
		};

		msdc1@default {
			phandle = <0x50>;

			pins_clk {
				drive-strength = [03];
			};

			pins_cmd {
				drive-strength = [03];
			};

			pins_dat {
				drive-strength = [03];
			};
		};

		msdc1@register_default {
			cmd_edge = [00];
			phandle = <0x54>;
			rdata_edge = [00];
			wdata_edge = [00];
		};

		msdc1@sdr104 {
			phandle = <0x51>;

			pins_clk {
				drive-strength = [03];
			};

			pins_cmd {
				drive-strength = [03];
			};

			pins_dat {
				drive-strength = [03];
			};
		};

		msdc1@sdr50 {
			phandle = <0x52>;

			pins_clk {
				drive-strength = [03];
			};

			pins_cmd {
				drive-strength = [03];
			};

			pins_dat {
				drive-strength = [03];
			};
		};

		msdc3@default {
			phandle = <0x90>;

			pins_clk {
				drive-strength = [04];
			};

			pins_cmd {
				drive-strength = [04];
			};

			pins_dat {
				drive-strength = [04];
			};
		};

		msdc3@register_default {
			cmd_edge = [01];
			phandle = <0x91>;
			rdata_edge = [01];
			wdata_edge = [01];
		};
	};

	pmic_clock_buffer_ctrl {
		compatible = "mediatek,pmic_clock_buffer";
		mediatek,bblpm-support = "enable";
		mediatek,clkbuf-config = <0x2 0x1 0x1 0x2 0x0 0x0 0x0>;
		mediatek,clkbuf-driving-current = <0x1 0x1 0x1 0x1 0x1 0x1 0x1>;
		mediatek,clkbuf-quantity = <0x7>;
		phandle = <0xfb>;
		pwrap = <0x12>;
		pwrap-dcxo-cfg = <0x18c 0x19c>;
		pwrap-dcxo-en = <0x188 0x0 0x188 0x1 0x188 0x0>;
		sleep = <0x7c>;
		spm-pwr-status = <0x180 0x0 0x180 0x1>;
	};

	pmu {
		compatible = "arm,armv8-pmuv3";
		interrupt-parent = <0xe>;
		interrupts = <0x1 0x7 0x8>;
	};

	psci {
		compatible = "arm,psci-1.0";
		method = "smc";
	};

	pseudo_m4u {
		compatible = "mediatek,mt-pseudo_m4u";
		iommus = <0x7d 0x2>;
	};

	pseudo_m4u-larb0 {
		compatible = "mediatek,mt-pseudo_m4u-port";
		iommus = <0x7d 0x0 0x7d 0x1 0x7d 0x2 0x7d 0x3 0x7d 0x4 0x7d 0x5 0x7d 0x6 0x7d 0x7>;
		mediatek,larbid = <0x0>;
	};

	pseudo_m4u-larb1 {
		compatible = "mediatek,mt-pseudo_m4u-port";
		iommus = <0x7d 0x20 0x7d 0x21>;
		mediatek,larbid = <0x1>;
	};

	pseudo_m4u-larb2 {
		compatible = "mediatek,mt-pseudo_m4u-port";
		iommus = <0x7d 0x40 0x7d 0x41>;
		mediatek,larbid = <0x2>;
	};

	pwm@11006000 {
		clock-names = "PWM1-main", "PWM2-main", "PWM3-main", "PWM4-main", "PWM5-main", "PWM6-main", "PWM-HCLK-main", "PWM-main";
		clocks = <0x22 0x10 0x22 0x11 0x22 0x12 0x22 0x13 0x22 0x14 0x22 0x30 0x22 0xf 0x22 0x15>;
		compatible = "mediatek,pwm";
		interrupts = <0x0 0x15 0x8>;
		phandle = <0xc1>;
		reg = <0x0 0x11006000 0x0 0x1000>;
	};

	pwrap@1000d000 {
		clock-names = "spi", "wrap", "ulposc";
		clocks = <0x21 0x22 0x2 0xf 0x85>;
		compatible = "mediatek,mt6761-pwrap", "syscon";
		interrupts = <0x0 0x7b 0x4>;
		phandle = <0x12>;
		reg = <0x0 0x1000d000 0x0 0x1000>;
		reg-names = "pwrap";

		main_pmic {
			#interrupt-cells = <0x2>;
			compatible = "mediatek,mt6357";
			interrupt-controller;
			interrupt-parent = <0x1e>;
			interrupts = <0x90 0x4 0x90 0x0>;
			phandle = <0x2b>;

			clock_buffer_ctrl {
				clkbuf-pmic-dependent = "pmic-drvcurr", "pmic-auxout-sel", "pmic-auxout-xo", "pmic-auxout-drvcurr", "pmic-auxout-bblpm-en";
				compatible = "mediatek,clock_buffer";
				n-clkbuf-pmic-dependent = <0x5>;
				n-pmic-auxout-bblpm-en = <0x1>;
				n-pmic-auxout-drvcurr = <0x7>;
				n-pmic-auxout-sel = <0x6>;
				n-pmic-auxout-xo = <0x7>;
				n-pmic-drvcurr = <0x7>;
				phandle = <0xb2>;
				pmic-auxout-bblpm-en = <0x7b6 0x0>;
				pmic-auxout-drvcurr = <0x7b6 0x1 0x7b6 0x7 0x7b6 0x1 0x7b6 0x7 0xffff 0xffff 0x7b6 0x1 0x7b6 0xc>;
				pmic-auxout-sel = <0x7b4 0x0 0x7b4 0x5 0x7b4 0x6 0x7b4 0x7 0x7b4 0x6 0x7b4 0x18>;
				pmic-auxout-xo = <0x7b6 0x0 0x7b6 0x6 0x7b6 0x0 0x7b6 0x6 0xffff 0xffff 0x7b6 0x6 0x7b6 0xc>;
				pmic-bblpm-sw = <0x788 0xc>;
				pmic-dcxo-cw = <0x788>;
				pmic-drvcurr = <0x7b0 0x0 0x7b0 0x2 0x7b0 0x4 0x7b0 0x6 0xffff 0xffff 0x7b0 0xa 0x7b0 0xc>;
				pmic-srclkeni3 = <0x44a 0x0>;
				pmic-xo-en = <0x788 0x2 0x788 0x5 0x788 0x8 0x788 0xb 0xffff 0xffff 0x7a2 0xa 0x7a2 0xd>;
				pmic-xo-mode = <0x788 0x0 0x788 0x3 0x788 0x6 0x788 0x9 0xffff 0xffff 0x7a2 0x8 0x7a2 0xb>;
			};

			leds-mt6357 {
				compatible = "mediatek,mt6357_leds";

				Isink1 {
					default-state = "off";
					label = "red";
					linux,default-trigger = "none";
					reg = <0x1>;
				};
			};

			mt6357_debug {
				compatible = "mediatek,mt63xx-debug";
			};

			mt6357_ts_buck1 {
				compatible = "mediatek,mt6357_ts_buck1";
				interconnects = <0x29 0x1>;
				io-channel-names = "pmic_buck1_temp";
				io-channels = <0x23 0x6>;
				phandle = <0x96>;
			};

			mt6357_ts_buck2 {
				compatible = "mediatek,mt6357_ts_buck2";
				interconnects = <0x29 0x1>;
				io-channel-names = "pmic_buck2_temp";
				io-channels = <0x23 0x7>;
				phandle = <0x97>;
			};

			mt6357keys {
				compatible = "mediatek,mt6357-keys";
				mediatek,long-press-mode = <0x1>;
				phandle = <0x95>;
				power-off-time-sec = <0x0>;

				home {
					linux,keycodes = <0x73>;
				};

				power {
					linux,keycodes = <0x74>;
					wakeup-source;
				};
			};

			mt6357regulator {
				compatible = "mediatek,mt6357-regulator";
				phandle = <0x98>;

				buck_vcore {
					phandle = <0x35>;
					regulator-enable-ramp-delay = <0xdc>;
					regulator-max-microvolt = <0x1406f4>;
					regulator-min-microvolt = <0x7ea5e>;
					regulator-name = "vcore";
					regulator-ramp-delay = <0x186a>;
				};

				buck_vmodem {
					phandle = <0x34>;
					regulator-enable-ramp-delay = <0xdc>;
					regulator-max-microvolt = <0x123716>;
					regulator-min-microvolt = <0x7a120>;
					regulator-name = "vmodem";
					regulator-ramp-delay = <0x186a>;
				};

				buck_vpa {
					phandle = <0x9b>;
					regulator-enable-ramp-delay = <0xdc>;
					regulator-max-microvolt = <0x37b1d0>;
					regulator-min-microvolt = <0x7a120>;
					regulator-name = "vpa";
					regulator-ramp-delay = <0xc350>;
				};

				buck_vproc {
					phandle = <0x9a>;
					regulator-enable-ramp-delay = <0xdc>;
					regulator-max-microvolt = <0x1406f4>;
					regulator-min-microvolt = <0x7ea5e>;
					regulator-name = "vproc";
					regulator-ramp-delay = <0x186a>;
				};

				buck_vs1 {
					phandle = <0x99>;
					regulator-enable-ramp-delay = <0xdc>;
					regulator-max-microvolt = <0x2191c0>;
					regulator-min-microvolt = <0x124f80>;
					regulator-name = "vs1";
					regulator-ramp-delay = <0x30d4>;
				};

				ldo_vaud28 {
					phandle = <0xa8>;
					regulator-enable-ramp-delay = <0x108>;
					regulator-max-microvolt = <0x2ab980>;
					regulator-min-microvolt = <0x2ab980>;
					regulator-name = "vaud28";
				};

				ldo_vaux18 {
					phandle = <0xa7>;
					regulator-enable-ramp-delay = <0x108>;
					regulator-max-microvolt = <0x1b7740>;
					regulator-min-microvolt = <0x1b7740>;
					regulator-name = "vaux18";
				};

				ldo_vcama {
					phandle = <0x6d>;
					regulator-enable-ramp-delay = <0x108>;
					regulator-max-microvolt = <0x2ab980>;
					regulator-min-microvolt = <0x2625a0>;
					regulator-name = "vcama";
				};

				ldo_vcamaf {
					phandle = <0x70>;
					regulator-enable-ramp-delay = <0x108>;
					regulator-max-microvolt = <0x2ab980>;
					regulator-min-microvolt = <0x2625a0>;
					regulator-name = "vcamaf";
				};

				ldo_vcamd {
					phandle = <0x6e>;
					regulator-enable-ramp-delay = <0x108>;
					regulator-max-microvolt = <0x1b7740>;
					regulator-min-microvolt = <0xf4240>;
					regulator-name = "vcamd";
				};

				ldo_vcamio {
					phandle = <0x6f>;
					regulator-enable-ramp-delay = <0x108>;
					regulator-max-microvolt = <0x1b7740>;
					regulator-min-microvolt = <0x1b7740>;
					regulator-name = "vcamio";
				};

				ldo_vcn18 {
					phandle = <0xa4>;
					regulator-enable-ramp-delay = <0x108>;
					regulator-max-microvolt = <0x1b7740>;
					regulator-min-microvolt = <0x1b7740>;
					regulator-name = "vcn18";
				};

				ldo_vcn28 {
					phandle = <0xa3>;
					regulator-enable-ramp-delay = <0x108>;
					regulator-max-microvolt = <0x2ab980>;
					regulator-min-microvolt = <0x2ab980>;
					regulator-name = "vcn28";
				};

				ldo_vcn33_bt {
					phandle = <0xa1>;
					regulator-enable-ramp-delay = <0x108>;
					regulator-max-microvolt = <0x3567e0>;
					regulator-min-microvolt = <0x325aa0>;
					regulator-name = "vcn33_bt";
				};

				ldo_vcn33_wifi {
					phandle = <0xa2>;
					regulator-enable-ramp-delay = <0x108>;
					regulator-max-microvolt = <0x3567e0>;
					regulator-min-microvolt = <0x325aa0>;
					regulator-name = "vcn33_wifi";
				};

				ldo_vdram {
					phandle = <0xab>;
					regulator-enable-ramp-delay = <0xce4>;
					regulator-max-microvolt = <0x124f80>;
					regulator-min-microvolt = <0x10c8e0>;
					regulator-name = "vdram";
				};

				ldo_vefuse {
					phandle = <0xa0>;
					regulator-enable-ramp-delay = <0x108>;
					regulator-max-microvolt = <0x325aa0>;
					regulator-min-microvolt = <0x124f80>;
					regulator-name = "vefuse";
				};

				ldo_vemc {
					phandle = <0x4f>;
					regulator-enable-ramp-delay = <0x2c>;
					regulator-max-microvolt = <0x325aa0>;
					regulator-min-microvolt = <0x2c4020>;
					regulator-name = "vemc";
				};

				ldo_vfe28 {
					phandle = <0x9c>;
					regulator-enable-ramp-delay = <0x108>;
					regulator-max-microvolt = <0x2ab980>;
					regulator-min-microvolt = <0x2ab980>;
					regulator-name = "vfe28";
				};

				ldo_vibr {
					phandle = <0x1f>;
					regulator-enable-ramp-delay = <0x2c>;
					regulator-max-microvolt = <0x325aa0>;
					regulator-min-microvolt = <0x124f80>;
					regulator-name = "vibr";
				};

				ldo_vio18 {
					phandle = <0xaa>;
					regulator-enable-ramp-delay = <0x108>;
					regulator-max-microvolt = <0x1b7740>;
					regulator-min-microvolt = <0x1b7740>;
					regulator-name = "vio18";
				};

				ldo_vio28 {
					phandle = <0xa9>;
					regulator-enable-ramp-delay = <0x108>;
					regulator-max-microvolt = <0x2ab980>;
					regulator-min-microvolt = <0x2ab980>;
					regulator-name = "vio28";
				};

				ldo_vldo28 {
					phandle = <0x71>;
					regulator-enable-ramp-delay = <0x108>;
					regulator-max-microvolt = <0x2dc6c0>;
					regulator-min-microvolt = <0x2ab980>;
					regulator-name = "vldo28";
				};

				ldo_vmc {
					phandle = <0x56>;
					regulator-enable-ramp-delay = <0x2c>;
					regulator-max-microvolt = <0x325aa0>;
					regulator-min-microvolt = <0x1b7740>;
					regulator-name = "vmc";
				};

				ldo_vmch {
					phandle = <0x55>;
					regulator-enable-ramp-delay = <0x2c>;
					regulator-max-microvolt = <0x325aa0>;
					regulator-min-microvolt = <0x2c4020>;
					regulator-name = "vmch";
				};

				ldo_vrf12 {
					phandle = <0x9f>;
					regulator-enable-ramp-delay = <0x6e>;
					regulator-max-microvolt = <0x124f80>;
					regulator-min-microvolt = <0x124f80>;
					regulator-name = "vrf12";
				};

				ldo_vrf18 {
					phandle = <0x9e>;
					regulator-enable-ramp-delay = <0x6e>;
					regulator-max-microvolt = <0x1b7740>;
					regulator-min-microvolt = <0x1b7740>;
					regulator-name = "vrf18";
				};

				ldo_vsim1 {
					phandle = <0xac>;
					regulator-enable-ramp-delay = <0x108>;
					regulator-max-microvolt = <0x2f4d60>;
					regulator-min-microvolt = <0x19f0a0>;
					regulator-name = "vsim1";
				};

				ldo_vsim2 {
					phandle = <0xad>;
					regulator-enable-ramp-delay = <0x108>;
					regulator-max-microvolt = <0x2f4d60>;
					regulator-min-microvolt = <0x19f0a0>;
					regulator-name = "vsim2";
				};

				ldo_vsram_others {
					phandle = <0xa5>;
					regulator-enable-ramp-delay = <0x6e>;
					regulator-max-microvolt = <0x1406f4>;
					regulator-min-microvolt = <0x7ea5e>;
					regulator-name = "vsram_others";
					regulator-ramp-delay = <0x186a>;
				};

				ldo_vsram_proc {
					phandle = <0xa6>;
					regulator-enable-ramp-delay = <0x6e>;
					regulator-max-microvolt = <0x1406f4>;
					regulator-min-microvolt = <0x7ea5e>;
					regulator-name = "vsram_proc";
					regulator-ramp-delay = <0x186a>;
				};

				ldo_vusb33 {
					phandle = <0xae>;
					regulator-enable-ramp-delay = <0x108>;
					regulator-max-microvolt = <0x2f4d60>;
					regulator-min-microvolt = <0x2dc6c0>;
					regulator-name = "vusb33";
				};

				ldo_vxo22 {
					phandle = <0x9d>;
					regulator-enable-ramp-delay = <0x6e>;
					regulator-max-microvolt = <0x249f00>;
					regulator-min-microvolt = <0x2191c0>;
					regulator-name = "vxo22";
				};
			};

			mt63xx-oc-debug {
				compatible = "mediatek,mt63xx-oc-debug";
			};

			mtk_battery_oc_throttling {
				compatible = "mediatek,mt6357-battery_oc_throttling";
				oc-thd-h = <0x123e>;
				oc-thd-l = <0x157c>;
			};

			mtk_charger_type {
				bc12_active = <0x1>;
				compatible = "mediatek,mt6357-charger-type";
				io-channel-names = "pmic_vbus";
				io-channels = <0x23 0x2>;
				phandle = <0x25>;
			};

			mtk_dynamic_loading_throttling {
				compatible = "mediatek,mt6357-dynamic_loading_throttling";
				io-channel-names = "pmic_ptim", "pmic_imix_r", "pmic_isense", "pmic_batadc";
				io-channels = <0x23 0xf 0x23 0x10 0x23 0x1 0x23 0x0>;
				isense_support;
				mediatek,charger = <0x2a>;
				uvlo-level = <0xa28>;
			};

			mtk_gauge {
				ACTIVE_TABLE = <0x6>;
				CAR_TUNE_VALUE = <0x64>;
				COM_FG_METER_RESISTANCE = <0x64>;
				COM_R_FG_VALUE = <0x0>;
				DIFFERENCE_FULLOCV_ITH = <0xc8>;
				EMBEDDED_SEL = <0x0>;
				FG_METER_RESISTANCE = <0x4b>;
				KEEP_100_PERCENT = <0x1>;
				MULTI_TEMP_GAUGE0 = <0x1>;
				PMIC_MIN_VOL = <0x82dc>;
				PMIC_SHUTDOWN_CURRENT = <0x14>;
				POWERON_SYSTEM_IBOOT = <0x1f4>;
				Q_MAX_SYS_VOLTAGE_BAT0 = <0xd16>;
				Q_MAX_SYS_VOLTAGE_BAT1 = <0xd16>;
				Q_MAX_SYS_VOLTAGE_BAT2 = <0xd16>;
				Q_MAX_SYS_VOLTAGE_BAT3 = <0xd16>;
				RBAT_PULL_UP_R = <0x4204>;
				RBAT_PULL_UP_VOLT = <0x708>;
				R_FG_VALUE = <0xa>;
				SHUTDOWN_1_TIME = <0x1e>;
				SHUTDOWN_GAUGE0_VOLTAGE = <0x84d0>;
				TEMPERATURE_T0 = <0x32>;
				TEMPERATURE_T1 = <0x19>;
				TEMPERATURE_T2 = <0xa>;
				TEMPERATURE_T3 = <0x0>;
				TEMPERATURE_T4 = <0xfffffffa>;
				TEMPERATURE_T5 = <0xfffffff6>;
				battery0_profile_t0 = <0x0 0xaa68 0x47e 0x12c 0xa9c6 0x47e 0x259 0xa933 0x47b 0x385 0xa8ac 0x478 0x4b2 0xa82a 0x476 0x5de 0xa7ab 0x473 0x70b 0xa72f 0x474 0x837 0xa6b5 0x478 0x964 0xa63c 0x476 0xa90 0xa5c6 0x47a 0xbbd 0xa550 0x47b 0xce9 0xa4dc 0x47f 0xe16 0xa468 0x47c 0xf42 0xa3f2 0x47b 0x106f 0xa382 0x483 0x119b 0xa311 0x48d 0x12c8 0xa2a0 0x48f 0x13f4 0xa232 0x493 0x1521 0xa1c4 0x49d 0x164d 0xa156 0x49b 0x177a 0xa0e9 0x4a2 0x18a6 0xa07e 0x4a6 0x19d3 0xa013 0x4ae 0x1aff 0x9fad 0x4ba 0x1c2c 0x9f43 0x4b9 0x1d58 0x9ee0 0x4c4 0x1e85 0x9e7c 0x4c5 0x1fb1 0x9e1c 0x4d5 0x20de 0x9dba 0x4dc 0x220a 0x9d5b 0x4e3 0x2337 0x9cfd 0x4ec 0x2463 0x9ca1 0x4fb 0x2590 0x9c49 0x506 0x26bc 0x9bf2 0x511 0x27e9 0x9b9f 0x51b 0x2915 0x9b48 0x523 0x2a42 0x9af7 0x538 0x2b6e 0x9aa3 0x543 0x2c9b 0x9a53 0x550 0x2dc7 0x9a02 0x55f 0x2ef4 0x99b0 0x569 0x3020 0x995c 0x56b 0x314d 0x9901 0x560 0x3279 0x9893 0x53a 0x33a6 0x9813 0x4eb 0x34d2 0x97a1 0x4b5 0x35ff 0x9742 0x496 0x372b 0x96f8 0x48e 0x3858 0x96b4 0x487 0x3984 0x9677 0x483 0x3ab1 0x963f 0x48b 0x3bdd 0x9607 0x482 0x3d0a 0x95d5 0x484 0x3e36 0x95a6 0x489 0x3f63 0x9576 0x48c 0x408f 0x954c 0x494 0x41bc 0x951f 0x493 0x42e8 0x94f7 0x49a 0x4415 0x94d0 0x49f 0x4541 0x94ab 0x4ad 0x466e 0x9489 0x4b1 0x479a 0x9467 0x4be 0x48c7 0x9446 0x4c0 0x49f3 0x9425 0x4c8 0x4b20 0x9408 0x4da 0x4c4c 0x93ec 0x4e2 0x4d79 0x93d2 0x4f0 0x4ea5 0x93b3 0x4f0 0x4fd2 0x939a 0x4f7 0x50fe 0x937b 0x4f3 0x522b 0x935b 0x4f0 0x5357 0x9324 0x4c9 0x5484 0x92d8 0x492 0x55b0 0x929b 0x490 0x56dd 0x9270 0x499 0x5809 0x924a 0x4a2 0x5936 0x921c 0x498 0x5a62 0x91f3 0x493 0x5b8f 0x91cc 0x48f 0x5cbb 0x91ac 0x49b 0x5de8 0x918d 0x4a6 0x5f14 0x9169 0x4aa 0x6041 0x913d 0x4b1 0x616d 0x9106 0x4a6 0x629a 0x90c6 0x49e 0x63c6 0x908e 0x4a2 0x64f3 0x9053 0x4aa 0x661f 0x9009 0x49f 0x674c 0x8fc3 0x483 0x6878 0x8fab 0x483 0x69a5 0x8fa1 0x4a2 0x6ad1 0x8f96 0x4c2 0x6bfe 0x8f8a 0x4ee 0x6d2a 0x8f6c 0x522 0x6e57 0x8f16 0x532 0x6f83 0x8e10 0x4ff 0x70b0 0x8c5f 0x513 0x71dc 0x8a1b 0x553 0x7309 0x86f8 0x5c7 0x7435 0x81d5 0x664>;
				battery0_profile_t0_col = <0x3>;
				battery0_profile_t0_num = <0x64>;
				battery0_profile_t1 = <0x0 0xaaef 0x635 0x12c 0xaa49 0x635 0x259 0xa9b8 0x634 0x385 0xa932 0x62a 0x4b2 0xa8b1 0x62a 0x5de 0xa830 0x622 0x70b 0xa7b6 0x622 0x837 0xa73e 0x62a 0x964 0xa6c7 0x62d 0xa90 0xa64d 0x619 0xbbd 0xa5d7 0x61b 0xce9 0xa563 0x61e 0xe16 0xa4f1 0x635 0xf42 0xa47c 0x63a 0x106f 0xa40c 0x639 0x119b 0xa398 0x635 0x12c8 0xa32b 0x645 0x13f4 0xa2bd 0x64b 0x1521 0xa24f 0x654 0x164d 0xa1e0 0x650 0x177a 0xa173 0x65f 0x18a6 0xa107 0x664 0x19d3 0xa09a 0x664 0x1aff 0xa02e 0x66c 0x1c2c 0x9fc7 0x696 0x1d58 0x9f5e 0x69e 0x1e85 0x9f0a 0x6bd 0x1fb1 0x9ecf 0x6eb 0x20de 0x9e89 0x71d 0x220a 0x9e0f 0x6f6 0x2337 0x9d6e 0x6cf 0x2463 0x9ccb 0x6e0 0x2590 0x9c49 0x6de 0x26bc 0x9be2 0x6e3 0x27e9 0x9b98 0x6fe 0x2915 0x9b65 0x72a 0x2a42 0x9b2f 0x730 0x2b6e 0x9af2 0x740 0x2c9b 0x9aa8 0x73b 0x2dc7 0x9a54 0x72e 0x2ef4 0x9a00 0x72c 0x3020 0x99a3 0x728 0x314d 0x9942 0x711 0x3279 0x98d8 0x6db 0x33a6 0x9864 0x695 0x34d2 0x97f6 0x659 0x35ff 0x9790 0x621 0x372b 0x973b 0x603 0x3858 0x96f2 0x5f2 0x3984 0x96af 0x5eb 0x3ab1 0x9671 0x5e0 0x3bdd 0x9639 0x5dc 0x3d0a 0x9604 0x5de 0x3e36 0x95d5 0x5e0 0x3f63 0x95a6 0x5eb 0x408f 0x9574 0x5ef 0x41bc 0x954b 0x5ec 0x42e8 0x9522 0x5f6 0x4415 0x94fd 0x603 0x4541 0x94d6 0x5ff 0x466e 0x94b3 0x612 0x479a 0x9491 0x613 0x48c7 0x946f 0x613 0x49f3 0x944d 0x61e 0x4b20 0x942f 0x632 0x4c4c 0x9415 0x64e 0x4d79 0x93f9 0x649 0x4ea5 0x93de 0x64b 0x4fd2 0x93bf 0x64b 0x50fe 0x93a6 0x640 0x522b 0x938e 0x650 0x5357 0x9370 0x650 0x5484 0x934e 0x63a 0x55b0 0x932f 0x631 0x56dd 0x9309 0x626 0x5809 0x92e6 0x619 0x5936 0x92c3 0x616 0x5a62 0x929c 0x613 0x5b8f 0x9271 0x608 0x5cbb 0x924f 0x60b 0x5de8 0x9234 0x625 0x5f14 0x9212 0x631 0x6041 0x91e6 0x633 0x616d 0x91b2 0x634 0x629a 0x917b 0x63c 0x63c6 0x913f 0x631 0x64f3 0x9109 0x64c 0x661f 0x90c6 0x65d 0x674c 0x907f 0x641 0x6878 0x904a 0x657 0x69a5 0x9028 0x654 0x6ad1 0x9019 0x677 0x6bfe 0x9009 0x695 0x6d2a 0x8ff5 0x6bf 0x6e57 0x8fc6 0x6fe 0x6f83 0x8f22 0x6f7 0x70b0 0x8e02 0x739 0x71dc 0x8c20 0x76c 0x7309 0x8971 0x7ea 0x7435 0x8545 0x84e>;
				battery0_profile_t1_col = <0x3>;
				battery0_profile_t1_num = <0x64>;
				battery0_profile_t2 = <0x0 0xaac8 0xdfc 0x12c 0xaa2a 0xdfc 0x259 0xa999 0xdc5 0x385 0xa91f 0xdc5 0x4b2 0xa89b 0xd9b 0x5de 0xa811 0xd52 0x70b 0xa79d 0xd4b 0x837 0xa729 0xd36 0x964 0xa6b7 0xd36 0xa90 0xa63f 0xd11 0xbbd 0xa5ce 0xcfd 0xce9 0xa55b 0xce9 0xe16 0xa4e8 0xcc7 0xf42 0xa477 0xcc3 0x106f 0xa406 0xcb3 0x119b 0xa396 0xc90 0x12c8 0xa325 0xc81 0x13f4 0xa2b9 0xc71 0x1521 0xa24f 0xc71 0x164d 0xa1e7 0xc81 0x177a 0xa17a 0xc7a 0x18a6 0xa111 0xc7c 0x19d3 0xa0a2 0xc81 0x1aff 0xa034 0xc51 0x1c2c 0x9fce 0xc58 0x1d58 0x9f70 0xc6d 0x1e85 0x9f29 0xca8 0x1fb1 0x9eea 0xce2 0x20de 0x9ea5 0xd10 0x220a 0x9e20 0xce1 0x2337 0x9d6f 0xc89 0x2463 0x9cbb 0xc5d 0x2590 0x9c1c 0xc1b 0x26bc 0x9ba7 0xc0c 0x27e9 0x9b4b 0xc1d 0x2915 0x9b00 0xc14 0x2a42 0x9aca 0xc43 0x2b6e 0x9a97 0xc62 0x2c9b 0x9a59 0xc59 0x2dc7 0x9a07 0xc1c 0x2ef4 0x99b0 0xc00 0x3020 0x994b 0xbd2 0x314d 0x98e3 0xba4 0x3279 0x987d 0xb56 0x33a6 0x981a 0xb1c 0x34d2 0x97b5 0xade 0x35ff 0x9760 0xad0 0x372b 0x970f 0xab8 0x3858 0x96ce 0xaa5 0x3984 0x9688 0xa8d 0x3ab1 0x965a 0xab0 0x3bdd 0x961f 0xaa0 0x3d0a 0x95ec 0xaa5 0x3e36 0x95b9 0xaa0 0x3f63 0x9588 0xaa4 0x408f 0x9560 0xacf 0x41bc 0x9532 0xabf 0x42e8 0x9509 0xade 0x4415 0x94e3 0xaf3 0x4541 0x94bd 0xaf9 0x466e 0x949a 0xb12 0x479a 0x9476 0xb15 0x48c7 0x9452 0xb1c 0x49f3 0x9435 0xb2c 0x4b20 0x9419 0xb3f 0x4c4c 0x93e6 0xb27 0x4d79 0x93d8 0xb4f 0x4ea5 0x93be 0xb5e 0x4fd2 0x939f 0xb56 0x50fe 0x9392 0xb7a 0x522b 0x937b 0xb8d 0x5357 0x9367 0xb9c 0x5484 0x9356 0xbab 0x55b0 0x933f 0xbc1 0x56dd 0x9326 0xbcb 0x5809 0x92ff 0xbbc 0x5936 0x92ed 0xbf3 0x5a62 0x92c7 0xc18 0x5b8f 0x929a 0xc14 0x5cbb 0x927e 0xc5b 0x5de8 0x925c 0xc85 0x5f14 0x9232 0xcce 0x6041 0x920f 0xd20 0x616d 0x91d2 0xd5f 0x629a 0x9196 0xda3 0x63c6 0x9164 0xe10 0x64f3 0x912b 0xe6e 0x661f 0x90ea 0xee4 0x674c 0x9093 0xf2f 0x6878 0x9055 0xfa6 0x69a5 0x903b 0x1052 0x6ad1 0x9027 0x10ee 0x6bfe 0x900c 0x11b7 0x6d2a 0x8ff8 0x12a0 0x6e57 0x8fd1 0x13cd 0x6f83 0x8f77 0x1545 0x70b0 0x8e70 0x163d 0x71dc 0x8cab 0x17d4 0x7309 0x8a3e 0x1a26 0x7435 0x86f1 0x1dab>;
				battery0_profile_t2_col = <0x3>;
				battery0_profile_t2_num = <0x64>;
				battery0_profile_t3 = <0x0 0xaae1 0x146b 0x12c 0xaa41 0x146b 0x258 0xa9bd 0x1474 0x384 0xa935 0x146f 0x4b0 0xa8af 0x1441 0x5dc 0xa82c 0x1413 0x708 0xa7ae 0x13f0 0x834 0xa734 0x13c5 0x960 0xa6c1 0x13a2 0xa8c 0xa651 0x137c 0xbb8 0xa5d8 0x1348 0xce4 0xa567 0x1341 0xe10 0xa4ef 0x131f 0xf3c 0xa47f 0x131b 0x1068 0xa407 0x12fb 0x1194 0xa39a 0x12e4 0x12c0 0xa331 0x12dd 0x13ec 0xa2cb 0x12d9 0x1518 0xa25c 0x12cd 0x1644 0xa1ef 0x12b2 0x1770 0xa187 0x12be 0x189c 0xa120 0x12ce 0x19c8 0xa0ab 0x12b6 0x1af4 0xa045 0x12b5 0x1c20 0x9fda 0x1290 0x1d4c 0x9f88 0x12a7 0x1e78 0x9f45 0x12c0 0x1fa4 0x9f0d 0x131a 0x20d0 0x9eb2 0x1323 0x21fc 0x9e22 0x12f5 0x2328 0x9d65 0x1298 0x2454 0x9ca6 0x1263 0x2580 0x9c0b 0x1235 0x26ac 0x9b8f 0x1210 0x27d8 0x9b2c 0x121b 0x2904 0x9ad6 0x1235 0x2a30 0x9a8f 0x121c 0x2b5c 0x9a54 0x1237 0x2c88 0x9a11 0x1235 0x2db4 0x99c5 0x121f 0x2ee0 0x9972 0x11ea 0x300c 0x9910 0x119b 0x3138 0x98b5 0x116c 0x3264 0x9858 0x113a 0x3390 0x97f6 0x1117 0x34bc 0x97a4 0x10ff 0x35e8 0x9755 0x10ed 0x3714 0x9709 0x10d4 0x3840 0x96c6 0x10cd 0x396c 0x9688 0x10cd 0x3a98 0x9651 0x10e1 0x3bc4 0x9614 0x10ee 0x3cf0 0x95e1 0x10ed 0x3e1c 0x95af 0x1110 0x3f48 0x9585 0x112a 0x4074 0x955d 0x1143 0x41a0 0x952d 0x1155 0x42cc 0x9500 0x1159 0x43f8 0x94df 0x1182 0x4524 0x94b4 0x119b 0x4650 0x9497 0x11c2 0x477c 0x9472 0x11d5 0x48a8 0x9456 0x11fd 0x49d4 0x9434 0x120c 0x4b00 0x9419 0x1236 0x4c2c 0x93f9 0x123e 0x4d58 0x93d8 0x1235 0x4e84 0x93c5 0x126b 0x4fb0 0x93ae 0x1277 0x50dc 0x939c 0x129b 0x5208 0x938c 0x12b9 0x5334 0x9378 0x12e2 0x5460 0x936b 0x12ec 0x558c 0x9357 0x1302 0x56b8 0x9349 0x132d 0x57e4 0x9334 0x1346 0x5910 0x931c 0x136f 0x5a3c 0x9304 0x13aa 0x5b68 0x92e1 0x13c4 0x5c94 0x92bc 0x140b 0x5dc0 0x929f 0x144c 0x5eec 0x9275 0x148e 0x6018 0x9248 0x14f7 0x6144 0x9218 0x155f 0x6270 0x91db 0x15b4 0x639c 0x919f 0x1620 0x64c8 0x9164 0x16af 0x65f4 0x9129 0x175f 0x6720 0x90dd 0x1806 0x684c 0x9096 0x18e0 0x6978 0x9069 0x19b1 0x6aa4 0x904f 0x1ae6 0x6bd0 0x9036 0x1c3f 0x6cfc 0x9020 0x1e0c 0x6e28 0x8fef 0x204e 0x6f54 0x8f96 0x22cd 0x7080 0x8ee9 0x25bd 0x71ac 0x8d73 0x2854 0x72d8 0x8b44 0x2b5c 0x7404 0x8846 0x2f53>;
				battery0_profile_t3_col = <0x3>;
				battery0_profile_t3_num = <0x64>;
				battery0_profile_t4 = <0x0 0xab6c 0x2f5d 0x12c 0xaa8e 0x2f5d 0x258 0xa9d3 0x2f18 0x384 0xa92c 0x2e76 0x4b0 0xa894 0x2dde 0x5dc 0xa805 0x2d2d 0x708 0xa77d 0x2c92 0x834 0xa6fc 0x2c02 0x960 0xa67d 0x2b4f 0xa8c 0xa605 0x2aac 0xbb8 0xa58b 0x2a23 0xce4 0xa518 0x29a9 0xe10 0xa4a4 0x293c 0xf3c 0xa434 0x28bb 0x1068 0xa3c3 0x2845 0x1194 0xa355 0x27f1 0x12c0 0xa2e9 0x27a6 0x13ec 0xa283 0x2751 0x1518 0xa216 0x2721 0x1644 0xa1a3 0x26ec 0x1770 0xa12f 0x2654 0x189c 0xa0d4 0x2627 0x19c8 0xa077 0x262e 0x1af4 0xa024 0x260e 0x1c20 0x9fcd 0x25fb 0x1d4c 0x9f75 0x25d4 0x1e78 0x9ef8 0x25c6 0x1fa4 0x9e60 0x254d 0x20d0 0x9db4 0x24d6 0x21fc 0x9d07 0x2439 0x2328 0x9c6b 0x23eb 0x2454 0x9bd8 0x23a3 0x2580 0x9b6b 0x236c 0x26ac 0x9b0a 0x2290 0x27d8 0x9ab6 0x237f 0x2904 0x9a62 0x2175 0x2a30 0x9a18 0x234e 0x2b5d 0x99cf 0x233d 0x2c89 0x9989 0x2351 0x2db5 0x993c 0x2323 0x2ee1 0x98ef 0x22ee 0x300d 0x98a7 0x22d9 0x3139 0x9858 0x22c7 0x3265 0x980d 0x22c1 0x3391 0x97c1 0x2287 0x34bd 0x977d 0x2296 0x35e9 0x973a 0x2283 0x3715 0x96f8 0x22aa 0x3841 0x96c0 0x229e 0x396d 0x968b 0x22cd 0x3a99 0x9655 0x22c9 0x3bc5 0x961a 0x22dd 0x3cf1 0x95ef 0x22e5 0x3e1d 0x95bd 0x22f1 0x3f49 0x9594 0x2314 0x4075 0x9565 0x2325 0x41a1 0x953e 0x2355 0x42cd 0x9518 0x2369 0x43f9 0x94f8 0x237b 0x4525 0x94cd 0x23a5 0x4651 0x94af 0x23b5 0x477d 0x9494 0x23ed 0x48a9 0x9484 0x240f 0x49d5 0x946a 0x2458 0x4b01 0x9457 0x246c 0x4c2d 0x9446 0x249f 0x4d59 0x9430 0x24f7 0x4e85 0x9423 0x2536 0x4fb1 0x9413 0x2560 0x50dd 0x9407 0x25bf 0x5209 0x93f2 0x2639 0x5335 0x93d9 0x268d 0x5461 0x93d0 0x25d0 0x558d 0x93bc 0x279f 0x56b9 0x93ad 0x2858 0x57e5 0x9391 0x28e7 0x5911 0x937a 0x299e 0x5a3d 0x9356 0x2a4a 0x5b69 0x9335 0x2b2c 0x5c95 0x9315 0x2c0a 0x5dc1 0x92f0 0x2d1d 0x5eed 0x92c0 0x2dfe 0x6019 0x9293 0x2d19 0x6145 0x9261 0x3061 0x6271 0x9229 0x31ad 0x639d 0x91ee 0x3300 0x64c9 0x91ac 0x343e 0x65f5 0x9172 0x35ba 0x6721 0x913b 0x3759 0x684d 0x9103 0x38cd 0x6979 0x90ce 0x3a7e 0x6aa5 0x90a4 0x3ca7 0x6bd1 0x9074 0x3eb0 0x6cfd 0x903e 0x4127 0x6e29 0x8fdc 0x43a7 0x6f55 0x8f16 0x45f7 0x7081 0x8de4 0x48c1 0x71ad 0x8c12 0x4bd7 0x72a4 0x8a03 0x4d23 0x7378 0x87d5 0x4c6e>;
				battery0_profile_t4_col = <0x3>;
				battery0_profile_t4_num = <0x64>;
				bootmode = <0x26>;
				charger = <0x25>;
				compatible = "mediatek,mt6357-gauge";
				enable_tmp_intr_suspend = <0x0>;
				g_FG_PSEUDO100_T0 = <0x64>;
				g_FG_PSEUDO100_T1 = <0x64>;
				g_FG_PSEUDO100_T2 = <0x64>;
				g_FG_PSEUDO100_T3 = <0x64>;
				g_FG_PSEUDO100_T4 = <0x64>;
				io-channel-names = "pmic_battery_temp", "pmic_battery_voltage", "pmic_bif_voltage", "pmic_ptim_voltage", "pmic_ptim_r";
				io-channels = <0x23 0x3 0x23 0x0 0x23 0xe 0x23 0xf 0x23 0x10>;
				nvmem-cell-names = "initialization", "state-of-charge";
				nvmem-cells = <0x27 0x28>;
				phandle = <0x7a>;
			};

			mtk_rtc {
				#address-cells = <0x1>;
				#size-cells = <0x1>;
				bootmode = <0x26>;
				compatible = "mediatek,mt6357-rtc";
				phandle = <0xaf>;

				ext_32k {
					bits = <0x6 0x1>;
					phandle = <0xb0>;
					reg = <0x2 0x1>;
				};

				fg_init {
					bits = <0x0 0x8>;
					phandle = <0x27>;
					reg = <0x0 0x1>;
				};

				fg_soc {
					bits = <0x0 0x8>;
					phandle = <0x28>;
					reg = <0x1 0x1>;
				};
			};

			mtk_ts_pmic {
				#interconnect-cells = <0x1>;
				compatible = "mediatek,mtk_ts_pmic";
				interconnects = <0x23 0x1>;
				io-channel-names = "pmic_chip_temp", "pmic_buck1_temp", "pmic_buck2_temp";
				io-channels = <0x23 0x5 0x23 0x6 0x23 0x7>;
				phandle = <0x29>;
			};

			pmic_accdet {
				accdet-mic-mode = <0x1>;
				accdet-mic-vol = <0x6>;
				accdet-name = "mt63xx-accdet";
				accdet-plugout-debounce = <0x1>;
				compatible = "mediatek,mt6357-accdet";
				headset-eint-level-pol = <0x8>;
				headset-eint-num = <0x0>;
				headset-eint-trig-mode = <0x0>;
				headset-four-key-threshold = <0x0 0x3a 0x79 0xc0 0x190>;
				headset-key-mode = <0x0>;
				headset-mode-setting = <0x500 0x500 0x1 0x1f0 0x800 0x800 0x20 0x44>;
				headset-three-key-threshold = <0x0 0x50 0xdc 0x190>;
				headset-three-key-threshold-CDD = <0x0 0x79 0xc0 0x258>;
				headset-use-ap-eint = <0x0>;
				io-channel-names = "pmic_accdet";
				io-channels = <0x23 0x9>;
				nvmem = <0x24>;
				nvmem-names = "mt63xx-accdet-efuse";
				phandle = <0x94>;
				status = "okay";
			};

			pmic_auxadc {
				#interconnect-cells = <0x1>;
				#io-channel-cells = <0x1>;
				compatible = "mediatek,pmic-auxadc", "mediatek,mt6357-auxadc";
				phandle = <0x23>;

				accdet {
					channel = <0x9>;
				};

				bat_temp {
					channel = <0x3>;
					resistance-ratio = <0x1 0x1>;
				};

				batadc {
					avg-num = <0x80>;
					channel = <0x0>;
					resistance-ratio = <0x3 0x1>;
				};

				chip_temp {
					channel = <0x5>;
				};

				dcxo_temp {
					avg-num = <0x10>;
					channel = <0xd>;
				};

				hpofs_cal {
					avg-num = <0x100>;
					channel = <0xc>;
				};

				imix_r {
					channel = <0x10>;
				};

				imp {
					avg-num = <0x80>;
					channel = <0xf>;
					resistance-ratio = <0x3 0x1>;
				};

				isense {
					avg-num = <0x80>;
					channel = <0x1>;
					resistance-ratio = <0x3 0x1>;
				};

				tsx_temp {
					avg-num = <0x80>;
					channel = <0xb>;
				};

				vbif {
					channel = <0xe>;
					resistance-ratio = <0x1 0x1>;
				};

				vcdt {
					channel = <0x2>;
				};

				vcore_temp {
					channel = <0x6>;
				};

				vproc_temp {
					channel = <0x7>;
				};
			};

			pmic_codec {
				compatible = "mediatek,mt6357-sound";
				io-channel-names = "pmic_codec", "pmic_accdet";
				io-channels = <0x23 0xc 0x23 0x9>;
				mediatek,pwrap-regmap = <0x12>;
				phandle = <0xb1>;
				use_hp_depop_flow = <0x0>;
				use_ul_260k = <0x0>;
			};

			pmic_efuse {
				#address-cells = <0x1>;
				#size-cells = <0x1>;
				compatible = "mediatek,mt6357-efuse";
				phandle = <0x24>;
			};

			pmic_lbat_service {
				compatible = "mediatek,mt6357-lbat_service";
			};
		};
	};

	radio_md_cfg {
		compatible = "mediatek,radio_md_cfg";
		phandle = <0xfe>;
	};

	regulator_vibrator {
		compatible = "regulator-vibrator";
		max-limit = <0x3a98>;
		max-volt = <0x30d400>;
		min-limit = <0xf>;
		min-volt = <0x231860>;
		vib-supply = <0x1f>;
	};

	reserved-memory {
		#address-cells = <0x2>;
		#size-cells = <0x2>;
		phandle = <0x84>;
		ranges;

		consys-reserve-memory {
			alignment = <0x0 0x1000000>;
			alloc-ranges = <0x0 0x40000000 0x0 0x80000000>;
			compatible = "mediatek,consys-reserve-memory";
			no-map;
			phandle = <0x48>;
			size = <0x0 0x400000>;
		};

		reserve-memory-scp_share {
			alignment = <0x0 0x1000000>;
			alloc-ranges = <0x0 0x40000000 0x0 0x50000000>;
			compatible = "mediatek,reserve-memory-scp_share";
			no-map;
			size = <0x0 0x300000>;
		};

		reserve-memory-sspm_share {
			alignment = <0x0 0x10000>;
			alloc-ranges = <0x0 0x40000000 0x0 0x60000000>;
			compatible = "mediatek,reserve-memory-sspm_share";
			no-map;
			size = <0x0 0x510000>;
			status = "okay";
		};

		ssmr-reserved-cma_memory {
			alignment = <0x0 0x1000000>;
			alloc-range = <0x0 0xc0000000 0x0 0x10000000>;
			compatible = "shared-dma-pool";
			phandle = <0x7b>;
			reusable;
			size = <0x0 0x10000000>;
		};

		wifi-reserve-memory {
			alignment = <0x0 0x1000000>;
			alloc-ranges = <0x0 0x40000000 0x0 0x80000000>;
			compatible = "shared-dma-pool";
			no-map;
			phandle = <0x49>;
			size = <0x0 0x300000>;
		};
	};

	rt-pd-manager {
		compatible = "mediatek,rt-pd-manager";
	};

	rt9465_slave_chr {
		compatible = "richtek,rt9465";
		phandle = <0xf9>;
		status = "disabled";
	};

	scp@10500000 {
		compatible = "mediatek,scp";
		core_1 = "enable";
		interrupts = <0x0 0x88 0x4>;
		phandle = <0xb3>;
		reg = <0x0 0x10500000 0x0 0x40000 0x0 0x105c0000 0x0 0x3000 0x0 0x105c4000 0x0 0x1000 0x0 0x105d4000 0x0 0x6000>;
		scp_feature_tbl = <0x0 0x2f 0x1 0x164 0x2 0x3e 0x3 0x2f 0x4 0x1a 0x5 0x0 0x6 0xc8 0x7 0x0 0x8 0x64 0x9 0xa>;
		scp_mem_key = "mediatek,reserve-memory-scp_share";
		scp_mem_tbl = <0x1 0x100000 0x4 0x200000>;
		scp_sramSize = <0x40000>;
		status = "okay";
	};

	scp_dvfs {
		clock-names = "clk_mux", "clk_pll_0", "clk_pll_1", "clk_pll_2", "clk_pll_3", "clk_pll_4", "clk_pll_5", "clk_pll_6";
		clocks = <0xf 0x6c 0x21 0xf 0x10 0xf 0x1d 0xf 0x4 0xf 0x1a 0xf 0x8 0xf 0x1c>;
		compatible = "mediatek,scp_dvfs";
		dvfs-opp = <0xff 0xff 0xff 0x0 0x0 0xfa 0x0 0xff 0xff 0xff 0x0 0x0 0x111 0x3 0xff 0xff 0xff 0x2 0x8 0x14a 0x5 0xff 0xff 0xff 0x3 0xc 0x1a0 0x6>;
		dvfsrc-opp-num = <0x3>;
		gpio = <0x16 0x1>;
		gpio-feature = "gpio-mode";
		gpio-feature-cfg = <0x0>;
		pmic = <0x2b>;
		pmic-feature = "pmic-vow-lp", "pmic-pmrc";
		pmic-feature-cfg = <0x0 0x0>;
	};

	scp_infra@10001000 {
		compatible = "mediatek,scpinfra";
		phandle = <0x86>;
		reg = <0x0 0x10001000 0x0 0x1000>;
	};

	scpsys@10001000 {
		#clock-cells = <0x1>;
		clock-names = "mm", "mfg", "mm-0", "mm-1", "mm-2", "mm-3", "cam-0", "cam-1", "cam-2", "cam-3";
		clocks = <0xf 0x6b 0xf 0x6d 0x10 0x15 0x10 0x16 0x10 0x13 0x10 0x14 0x11 0x0 0x11 0x1 0x10 0x19 0x10 0x18>;
		compatible = "mediatek,mt6761-scpsys", "syscon";
		phandle = <0x33>;
		reg = <0x0 0x10001000 0x0 0x1000 0x0 0x10006000 0x0 0x1000 0x0 0x14002000 0x0 0x1000 0x0 0x1020e000 0x0 0x1000 0x0 0x18004000 0x0 0x1000>;
	};

	security_ao@1001a000 {
		compatible = "mediatek,security_ao";
		reg = <0x0 0x1001a000 0x0 0x1000>;
	};

	serial@11020000 {
		clock-names = "baud", "bus";
		clocks = <0x21 0x22 0x16>;
		compatible = "mediatek,mt6761-uart", "mediatek,mt6577-uart";
		dma-names = "tx", "rx";
		dmas = <0x45 0x0 0x45 0x1>;
		interrupts = <0x0 0x23 0x8>;
		phandle = <0xbf>;
		reg = <0x0 0x11002000 0x0 0x1000>;
	};

	serial@11030000 {
		clock-names = "baud", "bus";
		clocks = <0x21 0x22 0x17>;
		compatible = "mediatek,mt6761-uart", "mediatek,mt6577-uart";
		dma-names = "tx", "rx";
		dmas = <0x45 0x2 0x45 0x3>;
		interrupts = <0x0 0x24 0x8>;
		phandle = <0xc0>;
		reg = <0x0 0x11003000 0x0 0x1000>;
	};

	sleep@10006000 {
		compatible = "mediatek,sleep", "syscon";
		interrupts = <0x0 0x7d 0x8>;
		mediatek,pwrap-regmap = <0x12>;
		phandle = <0x7c>;
		reg = <0x0 0x10006000 0x0 0x1000>;
		wakeup-source = <0x13 0x0 0x4 0x14 0x1 0x20 0x15 0x3 0x2000000>;
	};

	sleep_reg_md@1000f000 {
		compatible = "mediatek,sleep_reg_md";
		reg = <0x0 0x1000f000 0x0 0x1000>;
	};

	smart_pa {
		phandle = <0x89>;
	};

	smi_common@14002000 {
		clock-names = "apb", "gals0", "gals1", "smi";
		clocks = <0x33 0x3 0x10 0x15 0x10 0x16 0x10 0x13>;
		compatible = "mediatek,smi_common", "mediatek,mt6761-smi-common";
		mediatek,smi-cnt = <0x4>;
		mediatek,smi-id = <0x3>;
		mmsys_config = <0x38>;
		phandle = <0xe7>;
		reg = <0x0 0x14002000 0x0 0x1000>;
	};

	smi_larb0@14003000 {
		clock-names = "apb", "smi";
		clocks = <0x33 0x3 0x10 0x14>;
		compatible = "mediatek,smi_larb0", "mediatek,smi_larb", "mediatek,mt6761-smi-larb";
		mediatek,larb-id = <0x0>;
		mediatek,smi-id = <0x0>;
		phandle = <0x30>;
		reg = <0x0 0x14003000 0x0 0x1000>;
	};

	smi_larb1@17010000 {
		clock-names = "apb", "smi";
		clocks = <0x33 0x9 0x79 0x1>;
		compatible = "mediatek,smi_larb1", "mediatek,smi_larb", "mediatek,mt6761-smi-larb";
		mediatek,larb-id = <0x1>;
		mediatek,smi-id = <0x1>;
		phandle = <0x31>;
		reg = <0x0 0x17010000 0x0 0x1000>;
	};

	smi_larb2@15001000 {
		clock-names = "apb", "gals", "smi";
		clocks = <0x33 0x8 0x10 0x18 0x11 0x0>;
		compatible = "mediatek,smi_larb2", "mediatek,smi_larb", "mediatek,mt6761-smi-larb";
		mediatek,larb-id = <0x2>;
		mediatek,smi-id = <0x2>;
		phandle = <0x32>;
		reg = <0x0 0x15001000 0x0 0x1000>;
	};

	spi0@1100a000 {
		clock-names = "parent-clk", "sel-clk", "spi-clk";
		clocks = <0xf 0xd 0xf 0x74 0x22 0x1b>;
		compatible = "mediatek,mt6765-spi";
		interrupts = <0x0 0x3e 0x8>;
		mediatek,pad-select = <0x0>;
		phandle = <0xcd>;
		reg = <0x0 0x1100a000 0x0 0x1000>;
	};

	spi1@11010000 {
		clock-names = "parent-clk", "sel-clk", "spi-clk";
		clocks = <0xf 0xd 0xf 0x74 0x22 0x34>;
		compatible = "mediatek,mt6765-spi";
		interrupts = <0x0 0x42 0x8>;
		mediatek,pad-select = <0x0>;
		phandle = <0xd1>;
		reg = <0x0 0x11010000 0x0 0x1000>;
	};

	spi2@11012000 {
		clock-names = "parent-clk", "sel-clk", "spi-clk";
		clocks = <0xf 0xd 0xf 0x74 0x22 0x37>;
		compatible = "mediatek,mt6765-spi";
		interrupts = <0x0 0x48 0x8>;
		mediatek,pad-select = <0x0>;
		phandle = <0xd2>;
		reg = <0x0 0x11012000 0x0 0x1000>;
	};

	spi3@11013000 {
		clock-names = "parent-clk", "sel-clk", "spi-clk";
		clocks = <0xf 0xd 0xf 0x74 0x22 0x38>;
		compatible = "mediatek,mt6765-spi";
		interrupts = <0x0 0x49 0x8>;
		mediatek,pad-select = <0x0>;
		phandle = <0xd3>;
		reg = <0x0 0x11013000 0x0 0x1000>;
	};

	spi4@11014000 {
		clock-names = "parent-clk", "sel-clk", "spi-clk";
		clocks = <0xf 0xd 0xf 0x74 0x22 0x41>;
		compatible = "mediatek,mt6765-spi";
		interrupts = <0x0 0x27 0x8>;
		mediatek,pad-select = <0x0>;
		phandle = <0xd4>;
		reg = <0x0 0x11014000 0x0 0x1000>;
	};

	spi5@11015000 {
		clock-names = "parent-clk", "sel-clk", "spi-clk";
		clocks = <0xf 0xd 0xf 0x74 0x22 0x42>;
		compatible = "mediatek,mt6765-spi";
		interrupts = <0x0 0x28 0x8>;
		mediatek,pad-select = <0x0>;
		phandle = <0xd5>;
		reg = <0x0 0x11015000 0x0 0x1000>;
	};

	sramrom@10214000 {
		compatible = "mediatek,sramrom";
		reg = <0x0 0x10214000 0x0 0x1000>;
	};

	ssmr {
		compatible = "mediatek,trusted_mem";
		memory-region = <0x7b>;
	};

	sspm@10440000 {
		compatible = "mediatek,mt6761-sspm";
		interrupt-names = "ipc", "mbox0", "mbox1", "mbox2", "mbox3", "mbox4";
		interrupts = <0x0 0x92 0x4 0x0 0x95 0x4 0x0 0x96 0x4 0x0 0x97 0x4 0x0 0x98 0x4 0x0 0x99 0x4>;
		reg = <0x0 0x10440000 0x0 0x10000 0x0 0x10450000 0x0 0x100 0x0 0x10451000 0x0 0x8 0x0 0x10460000 0x0 0x100 0x0 0x10461000 0x0 0x8 0x0 0x10470000 0x0 0x100 0x0 0x10471000 0x0 0x8 0x0 0x10480000 0x0 0x100 0x0 0x10481000 0x0 0x8 0x0 0x10490000 0x0 0x100 0x0 0x10491000 0x0 0x8>;
		reg-names = "cfgreg", "mbox0_base", "mbox0_ctrl", "mbox1_base", "mbox1_ctrl", "mbox2_base", "mbox2_ctrl", "mbox3_base", "mbox3_ctrl", "mbox4_base", "mbox4_ctrl";
	};

	sys_cirq@10204000 {
		compatible = "mediatek,sys_cirq";
		interrupts = <0x0 0xe0 0x8>;
		mediatek,cirq_num = <0xd1>;
		mediatek,spi_start_offset = <0x10>;
		reg = <0x0 0x10204000 0x0 0x1000>;
	};

	syscfg_pctl_0@10005000 {
		compatible = "mediatek,mt6761-pctl-0-syscfg", "syscon";
		phandle = <0x8e>;
		reg = <0x0 0x10005000 0x0 0x1000>;
	};

	tcpc_pd {
		phandle = <0x8a>;
	};

	therm_ctrl@1100b000 {
		clock-names = "therm-main";
		clocks = <0x22 0xa>;
		compatible = "mediatek,therm_ctrl";
		interrupts = <0x0 0x16 0x8>;
		nvmem = <0x44>;
		nvmem-cell-names = "cpu_freq_segment_cell", "thermal_efuse_cell";
		nvmem-cells = <0x46 0x47>;
		nvmem-names = "mtk_efuse";
		reg = <0x0 0x1100b000 0x0 0x1000>;
	};

	thermal-sensor1 {
		compatible = "mediatek,mtboard-thermistor1";
		interconnects = <0x36 0x0>;
		io-channel-names = "thermistor-ch0";
		io-channels = <0x36 0x0>;
		phandle = <0xce>;
	};

	thermal-sensor2 {
		compatible = "mediatek,mtboard-thermistor2";
		interconnects = <0x36 0x1>;
		io-channel-names = "thermistor-ch1";
		io-channels = <0x36 0x1>;
		phandle = <0xcf>;
	};

	thermal-sensor3 {
		compatible = "mediatek,mtboard-thermistor3";
		interconnects = <0x36 0x2>;
		io-channel-names = "thermistor-ch2";
		io-channels = <0x36 0x2>;
		phandle = <0xd0>;
	};

	timer {
		clock-frequency = <0xc65d40>;
		compatible = "arm,armv8-timer";
		interrupt-parent = <0xe>;
		interrupts = <0x1 0xd 0x8 0x1 0xe 0x8 0x1 0xb 0x8 0x1 0xa 0x8>;
	};

	timer@10017000 {
		clocks = <0x2f>;
		compatible = "mediatek,sys_timer", "mediatek,mt6761-timer", "mediatek,mt6765-timer";
		interrupts = <0x0 0x8a 0x4>;
		phandle = <0xb9>;
		reg = <0x0 0x10017000 0x0 0x1000>;
		reg-names = "sys_timer_base";
	};

	tkcore {
		compatible = "trustkernel,tkcore";
		interrupts = <0x0 0xc4 0x1>;
	};

	topckgen@10000000 {
		#clock-cells = <0x1>;
		compatible = "mediatek,mt6761-topckgen", "syscon";
		phandle = <0xf>;
		reg = <0x0 0x10000000 0x0 0x1000>;
	};

	topckgen_ao@1001b000 {
		compatible = "mediatek,topckgen_ao";
		reg = <0x0 0x1001b000 0x0 0x1000>;
	};

	topmisc@10011000 {
		compatible = "mediatek,topmisc";
		reg = <0x0 0x10011000 0x0 0x1000>;
	};

	toprgu@10007000 {
		#reset-cells = <0x1>;
		compatible = "mediatek,mt6761-wdt", "mediatek,mt6589-wdt", "mediatek,toprgu", "syscon", "simple-mfd";
		interrupts = <0x0 0x53 0x0>;
		mediatek,rg_dfd_timeout = <0xa0>;
		phandle = <0x43>;
		reg = <0x0 0x10007000 0x0 0x1000>;

		reboot-mode {
			compatible = "syscon-reboot-mode";
			mask = <0xf>;
			mode-bootloader = <0x3>;
			mode-charger = <0x1>;
			mode-ddr-reserve = <0x6>;
			mode-dm-verity-dev-corrupt = <0x4>;
			mode-kpoc = <0x5>;
			mode-meta = <0x7>;
			mode-recovery = <0x2>;
			mode-rpmbpk = <0x8>;
			offset = <0x24>;
		};
	};

	touch {
		compatible = "goodix,touch";
		phandle = <0xb5>;
	};

	trng@1020f000 {
		compatible = "mediatek,trng";
		interrupts = <0x0 0x69 0x8>;
		reg = <0x0 0x1020f000 0x0 0x1000>;
	};

	type_c_port0 {
		charger = <0x7e>;
		mt-tcpc,name = "type_c_port0";
		mt-tcpc,notifier_supply_num = <0x3>;
		mt-tcpc,role_def = <0x4>;
		mt-tcpc,rp_level = <0x1>;
		mt-tcpc,vconn_supply = <0x1>;
		mt6370pd,intr_gpio = <0x1e 0x18 0x0>;
		mt6370pd,intr_gpio_num = <0x18>;
		phandle = <0x104>;
		tcpc-dual,supported_modes = <0x0>;

		displayport {
			1st_connection = "dfp_d";
			2nd_connection = "dfp_d";
			signal,dp_v13;
			typec,receptacle;
			usbr20_not_used;

			dfp_d {
				pin_assignment,mode_c;
				pin_assignment,mode_d;
				pin_assignment,mode_e;
				pin_assignment,mode_f;
			};

			ufp_d {
			};
		};

		dpm_caps {
			attemp_discover_cable;
			attemp_discover_id;
			attemp_enter_dp_mode;
			dr_check = <0x0>;
			local_dr_data;
			local_dr_power;
			local_no_suspend;
			local_usb_comm;
			local_vconn_supply;
			pr_check = <0x0>;
		};

		pd-data {
			bat,nr = <0x1>;
			pd,charging_policy = <0x31>;
			pd,country_nr = <0x0>;
			pd,id-vdo-data = <0xd10029cf 0x0 0x50810000>;
			pd,id-vdo-size = <0x3>;
			pd,mfrs = "RichtekTCPC";
			pd,pid = <0x5081>;
			pd,sink-pdo-data = <0x190c8>;
			pd,sink-pdo-size = <0x1>;
			pd,source-cap-ext = <0x508129cf 0x0 0x0 0x0 0x0 0x7000000>;
			pd,source-pdo-data = <0x19096>;
			pd,source-pdo-size = <0x1>;
			pd,vid = <0x29cf>;

			bat-info0 {
				bat,design_cap = <0xbb8>;
				bat,mfrs = "bat1";
				bat,pid = <0x5081>;
				bat,vid = <0x29cf>;
			};
		};
	};

	usb0@11200000 {
		charger = <0x25>;
		clock-names = "usb0", "usb0_clk_top_sel", "usb0_clk_univpll3_d4";
		clocks = <0x22 0x8 0xf 0x7f 0xf 0x23>;
		compatible = "mediatek,mt6761-usb20";
		interrupts = <0x0 0x11 0x8>;
		mode = <0x2>;
		multipoint = <0x1>;
		num_eps = <0x10>;
		nvmem-cell-names = "efuse_idx107";
		nvmem-cells = <0x4a>;
		phandle = <0xd6>;
		reg = <0x0 0x11200000 0x0 0x10000 0x0 0x11cc0000 0x0 0x10000>;
	};

	usb1p_sif@11210000 {
		compatible = "mediatek,usb1p_sif";
		reg = <0x0 0x11210000 0x0 0x10000>;
	};

	usb_sif@11210000 {
		compatible = "mediatek,usb_sif";
		reg = <0x0 0x11210000 0x0 0x1000>;
	};

	utos {
		compatible = "microtrust,utos";
		interrupts = <0x0 0xbc 0x1 0x0 0xbd 0x1>;
	};

	utos_tester {
		compatible = "microtrust,tester-v1";
	};

	vcodecsys@17000000 {
		#clock-cells = <0x1>;
		compatible = "mediatek,mt6761-vcodecsys", "syscon";
		phandle = <0x79>;
		reg = <0x0 0x17000000 0x0 0x10000>;
	};

	vdec@17040000 {
		compatible = "mediatek,vdec";
		interrupts = <0x0 0xb1 0x8>;
		reg = <0x0 0x17040000 0x0 0x10000>;
	};

	venc@17020000 {
		compatible = "mediatek,venc";
		interrupts = <0x0 0xae 0x8>;
		reg = <0x0 0x17020000 0x0 0x10000>;
	};

	venc_gcon@17000000 {
		clock-names = "MT_SCP_SYS_DIS", "MT_SCP_SYS_VCODEC", "MT_CG_MM_SMI_COMM0", "MT_CG_MM_SMI_COMM1", "MT_CG_MM_SMI_COMMON", "MT_CG_VDEC", "MT_CG_VENC";
		clocks = <0x33 0x3 0x33 0x9 0x10 0x15 0x10 0x16 0x10 0x13 0x79 0x3 0x79 0x1>;
		compatible = "mediatek,venc_gcon", "syscon";
		phandle = <0xef>;
		reg = <0x0 0x17000000 0x0 0x10000>;
	};

	venc_jpg@17030000 {
		clock-names = "MT_CG_VENC_JPGENC";
		clocks = <0x79 0x2>;
		compatible = "mediatek,venc_jpg";
		interrupts = <0x0 0xb0 0x8>;
		reg = <0x0 0x17030000 0x0 0x10000>;
	};

	wifi@18000000 {
		compatible = "mediatek,wifi";
		interrupts = <0x0 0xd4 0x8>;
		memory-region = <0x49>;
		reg = <0x0 0x18000000 0x0 0x100000>;
	};
};
